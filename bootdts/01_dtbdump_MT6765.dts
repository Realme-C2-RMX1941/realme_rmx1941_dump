/dts-v1/;

/ {
	#address-cells = <0x02>;
	#size-cells = <0x02>;
	compatible = "mediatek,MT6765";
	interrupt-parent = <0x01>;
	model = "MT6765";

	__symbols__ {
		DPIDLE = "/cpus/idle-states/dpidle";
		MCDI_CLUSTER = "/cpus/idle-states/mcdi-cluster";
		MCDI_CPU = "/cpus/idle-states/mcdi-cpu";
		SODI = "/cpus/idle-states/sodi";
		SODI3 = "/cpus/idle-states/sodi3";
		STANDBY = "/cpus/idle-states/standby";
		SUSPEND = "/cpus/idle-states/suspend";
		accdet = "/accdet";
		alsps_mtk = "/alsps_mtk";
		apdma = "/dma-controller@11000580";
		apmixed = "/apmixed@1000c000";
		audgpio = "/mt_soc_dl1_pcm@11220000";
		audio = "/audio@11220000";
		auxadc = "/auxadc@11001000";
		bat_gm30 = "/battery";
		btcvsd_snd = "/mtk-btcvsd-snd@18050000";
		camsys = "/camsys@1a000000";
		charger = "/charger";
		chosen = "/chosen";
		chr_stat = "/chr_stat";
		clk26m = "/clocks/clk26m";
		clk32k = "/clocks/clk32k";
		consys = "/consys@18002000";
		cpu0 = "/cpus/cpu@000";
		cpu1 = "/cpus/cpu@001";
		cpu2 = "/cpus/cpu@002";
		cpu3 = "/cpus/cpu@003";
		cpu4 = "/cpus/cpu@100";
		cpu5 = "/cpus/cpu@101";
		cpu6 = "/cpus/cpu@102";
		cpu7 = "/cpus/cpu@103";
		cpu_dbgapb = "/cpu_dbgapb@0d410000";
		disp_color0 = "/disp_color0@1400f000";
		disp_mutex0 = "/disp_mutex0@14001000";
		dsi_te = "/dsi_te";
		dynamic_options = "/dynamic_options";
		flashlight_core = "/flashlight_core";
		flashlight_pins_default = "/pinctrl@1000b000/flashlight_pins_default";
		flashlight_pins_srobe_off = "/pinctrl@1000b000/flashlight_pins_srobe_off";
		flashlight_pins_srobe_on = "/pinctrl@1000b000/flashlight_pins_srobe_on";
		flashlight_pins_torch_off = "/pinctrl@1000b000/flashlight_pins_torch_off";
		flashlight_pins_torch_on = "/pinctrl@1000b000/flashlight_pins_torch_on";
		flashlight_pins_torch_pwm = "/pinctrl@1000b000/flashlight_pins_torch_pwm";
		flashlights_gpio = "/flashlights_gpio";
		flashlights_mt6370 = "/flashlights_mt6370";
		gce = "/gce@10238000";
		gce_mbox = "/gce_mbox@10238000";
		gce_mbox_svp = "/gce_mbox_svp@10238000";
		gic = "/interrupt-controller@0c000000";
		goodix_fp = "/fingerprint";
		gpio = "/gpio@10005000";
		gpio_usage_mapping = "/gpio";
		gse_1 = "/gse_1";
		i2c0 = "/i2c0@11007000";
		i2c1 = "/i2c1@11008000";
		i2c2 = "/i2c2@11009000";
		i2c3 = "/i2c3@1100f000";
		i2c4 = "/i2c4@11011000";
		i2c5 = "/i2c5@11016000";
		i2c6 = "/i2c6@1100d000";
		i2c7 = "/i2c7";
		i2c8 = "/i2c8";
		i2c9 = "/i2c9";
		i2c_common = "/i2c_common";
		iddig_high = "/pinctrl@1000b000/iddig_high";
		iddig_low = "/pinctrl@1000b000/iddig_low";
		imgsys = "/imgsys@15020000";
		infracfg_ao = "/infracfg_ao@10001000";
		iommu = "/m4u@10205000";
		irq_nfc = "/irq_nfc";
		irtx_pwm = "/irtx_pwm";
		kd_camera_hw1 = "/kd_camera_hw1@1a040000";
		keypad = "/kp@10010000";
		lcm = "/lcm";
		lk_charger = "/lk_charger";
		main_pmic = "/mt-pmic";
		md1_sim1_hot_plug_eint = "/md1_sim1_hot_plug_eint";
		md1_sim2_hot_plug_eint = "/md1_sim2_hot_plug_eint";
		mdcldma = "/mdcldma@10014000";
		mdp_ccorr = "/mdp_ccorr0@14005000";
		mdp_rdma0 = "/mdp_rdma0@14004000";
		mdp_rsz0 = "/mdp_rsz0@14006000";
		mdp_rsz1 = "/mdp_rsz1@14007000";
		mdp_tdshp0 = "/mdp_tdshp0@1400a000";
		mdp_wdma0 = "/mdp_wdma0@14008000";
		mdp_wrot0 = "/mdp_wrot0@14009000";
		memory_ssmr_features = "/memory-ssmr-features";
		mfg_cfg = "/mfg_cfg@13ffe000";
		mipi_rx_ana_csi0a = "/mipi_rx_ana_csi0a@11c10000";
		mipi_rx_ana_csi0b = "/mipi_rx_ana_csi0b@11c11000";
		mipi_rx_ana_csi1a = "/mipi_rx_ana_csi1a@11c12000";
		mipi_rx_ana_csi1b = "/mipi_rx_ana_csi1b@11c13000";
		mipi_rx_ana_csi2a = "/mipi_rx_ana_csi2a@11c14000";
		mipi_rx_ana_csi2b = "/mipi_rx_ana_csi2b@11c15000";
		mmsys_config = "/mmsys_config@14000000";
		mrdump_ext_rst = "/mrdump_ext_rst";
		msdc0 = "/msdc@11230000";
		msdc0_pins_default = "/pinctrl@1000b000/msdc0@default";
		msdc0_pins_hs200 = "/pinctrl@1000b000/msdc0@hs200";
		msdc0_pins_hs400 = "/pinctrl@1000b000/msdc0@hs400";
		msdc0_register_setting_default = "/pinctrl@1000b000/msdc0@register_default";
		msdc1 = "/msdc@11240000";
		msdc1_ins = "/msdc1_ins@0";
		msdc1_pins_ddr50 = "/pinctrl@1000b000/msdc1@ddr50";
		msdc1_pins_default = "/pinctrl@1000b000/msdc1@default";
		msdc1_pins_sdr104 = "/pinctrl@1000b000/msdc1@sdr104";
		msdc1_pins_sdr50 = "/pinctrl@1000b000/msdc1@sdr50";
		msdc1_register_setting_default = "/pinctrl@1000b000/msdc1@register_default";
		msdc2 = "/msdc@11250000";
		msdc3 = "/msdc@11260000";
		msdc3_pins_default = "/pinctrl@1000b000/msdc3@default";
		msdc3_register_setting_default = "/pinctrl@1000b000/msdc3@register_default";
		mt6370_pmu = "/mt6370_pmu_dts";
		mt6370_typec = "/type_c_port0";
		mt_charger = "/mt_charger";
		mt_pmic_vaud28_ldo_reg = "/mt-pmic/ldo_regulators/ldo_vaud28";
		mt_pmic_vaux18_ldo_reg = "/mt-pmic/ldo_regulators/ldo_vaux18";
		mt_pmic_vcama_ldo_reg = "/mt-pmic/ldo_regulators/ldo_vcama";
		mt_pmic_vcamd_ldo_reg = "/mt-pmic/ldo_regulators/ldo_vcamd";
		mt_pmic_vcamio_ldo_reg = "/mt-pmic/ldo_regulators/ldo_vcamio";
		mt_pmic_vcn18_ldo_reg = "/mt-pmic/ldo_regulators/ldo_vcn18";
		mt_pmic_vcn28_ldo_reg = "/mt-pmic/ldo_regulators/ldo_vcn28";
		mt_pmic_vcn33_bt_ldo_reg = "/mt-pmic/ldo_regulators/ldo_vcn33_bt";
		mt_pmic_vcn33_wifi_ldo_reg = "/mt-pmic/ldo_regulators/ldo_vcn33_wifi";
		mt_pmic_vcore_buck_reg = "/mt-pmic/buck_regulators/buck_vcore";
		mt_pmic_vdram_ldo_reg = "/mt-pmic/ldo_regulators/ldo_vdram";
		mt_pmic_vefuse_ldo_reg = "/mt-pmic/ldo_regulators/ldo_vefuse";
		mt_pmic_vemc_ldo_reg = "/mt-pmic/ldo_regulators/ldo_vemc";
		mt_pmic_vfe28_ldo_reg = "/mt-pmic/ldo_regulators/ldo_vfe28";
		mt_pmic_vibr_ldo_reg = "/mt-pmic/ldo_regulators/ldo_vibr";
		mt_pmic_vio18_ldo_reg = "/mt-pmic/ldo_regulators/ldo_vio18";
		mt_pmic_vio28_ldo_reg = "/mt-pmic/ldo_regulators/ldo_vio28";
		mt_pmic_vldo28_ldo_reg = "/mt-pmic/ldo_regulators/ldo_vldo28";
		mt_pmic_vmc_ldo_reg = "/mt-pmic/ldo_regulators/ldo_vmc";
		mt_pmic_vmch_ldo_reg = "/mt-pmic/ldo_regulators/ldo_vmch";
		mt_pmic_vmodem_buck_reg = "/mt-pmic/buck_regulators/buck_vmodem";
		mt_pmic_vpa_buck_reg = "/mt-pmic/buck_regulators/buck_vpa";
		mt_pmic_vproc_buck_reg = "/mt-pmic/buck_regulators/buck_vproc";
		mt_pmic_vrf12_ldo_reg = "/mt-pmic/ldo_regulators/ldo_vrf12";
		mt_pmic_vrf18_ldo_reg = "/mt-pmic/ldo_regulators/ldo_vrf18";
		mt_pmic_vs1_buck_reg = "/mt-pmic/buck_regulators/buck_vs1";
		mt_pmic_vsim1_ldo_reg = "/mt-pmic/ldo_regulators/ldo_vsim1";
		mt_pmic_vsim2_ldo_reg = "/mt-pmic/ldo_regulators/ldo_vsim2";
		mt_pmic_vsram_others_ldo_reg = "/mt-pmic/ldo_regulators/ldo_vsram_others";
		mt_pmic_vsram_proc_ldo_reg = "/mt-pmic/ldo_regulators/ldo_vsram_proc";
		mt_pmic_vusb33_ldo_reg = "/mt-pmic/ldo_regulators/ldo_vusb33";
		mt_pmic_vxo22_ldo_reg = "/mt-pmic/ldo_regulators/ldo_vxo22";
		mtkfb = "/mtkfb@0";
		nfc = "/nfc";
		odm = "/odm";
		oppo_secure_common = "/oppo_secure_common";
		otg_iddig = "/otg_iddig";
		pericfg = "/pericfg@10003000";
		pio = "/pinctrl@1000b000";
		pmic_auxadc = "/mt-pmic/mt635x-auxadc";
		pmic_clock_buffer_ctrl = "/pmic_clock_buffer_ctrl";
		pwm = "/pwm@11006000";
		radio_md_cfg = "/radio_md_cfg";
		reserved_memory = "/reserved-memory";
		rt9465_slave_chr = "/rt9465_slave_chr";
		scpsys = "/scpsys@10001000";
		smart_pa = "/smart_pa";
		smi_larb0 = "/smi_larb0@14003000";
		smi_larb1 = "/smi_larb1@17010000";
		smi_larb2 = "/smi_larb2@15021000";
		smi_larb3 = "/smi_larb3@1a002000";
		spi0 = "/spi@1100a000";
		spi1 = "/spi@11010000";
		spi2 = "/spi@11012000";
		spi3 = "/spi@11013000";
		spi4 = "/spi@11014000";
		spi5 = "/spi@11015000";
		subpmic_pmu_eint = "/mt6370_pmu_eint";
		swtp = "/swtp";
		syscfg_pctl_0 = "/syscfg_pctl_0@10005000";
		syscfg_pctl_1 = "/syscfg_pctl_1@0x10002000";
		syscfg_pctl_2 = "/syscfg_pctl_2@0x10002200";
		syscfg_pctl_3 = "/syscfg_pctl_3@0x10002400";
		syscfg_pctl_4 = "/syscfg_pctl_4@0x10002600";
		syscfg_pctl_5 = "/syscfg_pctl_5@0x10002800";
		syscfg_pctl_6 = "/syscfg_pctl_6@0x10002a00";
		syscfg_pctl_7 = "/syscfg_pctl_7@0x10002c00";
		sysirq = "/intpol-controller@10200a80";
		tcpc_pd = "/mt6370_pd_eint";
		topckgen = "/topckgen@10000000";
		touch = "/touch";
		uart0 = "/serial@11020000";
		uart1 = "/serial@11030000";
		venc_gcon = "/venc_gcon@17000000";
	};

	accdet {
		compatible = "mediatek,pmic-accdet";
		linux,phandle = <0x80>;
		phandle = <0x80>;
	};

	aes_top0@10016000 {
		compatible = "mediatek,aes_top0";
		reg = <0x00 0x10016000 0x00 0x1000>;
	};

	alsps_mtk {
		linux,phandle = <0xb5>;
		phandle = <0xb5>;
	};

	amms_control {
		compatible = "mediatek,amms";
		interrupts = <0x00 0x86 0x01>;
	};

	ap_ccif0@10209000 {
		compatible = "mediatek,ap_ccif0";
		interrupts = <0x00 0x94 0x08>;
		reg = <0x00 0x10209000 0x00 0x1000>;
	};

	ap_ccif1@1020b000 {
		compatible = "mediatek,ap_ccif1";
		interrupts = <0x00 0x96 0x08>;
		reg = <0x00 0x1020b000 0x00 0x1000>;
	};

	ap_ccif2@1023c000 {
		compatible = "mediatek,ap_ccif2";
		interrupts = <0x00 0x8f 0x08>;
		reg = <0x00 0x1023c000 0x00 0x1000>;
	};

	ap_ccif3@1023e000 {
		compatible = "mediatek,ap_ccif3";
		interrupts = <0x00 0x92 0x08>;
		reg = <0x00 0x1023e000 0x00 0x1000>;
	};

	ap_dma@11000000 {
		compatible = "mediatek,ap_dma";
		interrupts = <0x00 0x61 0x08>;
		reg = <0x00 0x11000000 0x00 0x1000>;
	};

	apcldmain@1021b000 {
		compatible = "mediatek,apcldmain";
		reg = <0x00 0x1021b000 0x00 0x00>;
	};

	apcldmain_ao@10014000 {
		compatible = "mediatek,apcldmain_ao";
		reg = <0x00 0x10014000 0x00 0x400>;
	};

	apcldmamisc@1021b800 {
		compatible = "mediatek,apcldmamisc";
		interrupts = <0x00 0xa5 0x04>;
		reg = <0x00 0x1021b800 0x00 0x00>;
	};

	apcldmamisc_ao@10014800 {
		compatible = "mediatek,apcldmamisc_ao";
		reg = <0x00 0x10014800 0x00 0x400>;
	};

	apcldmaout@1021b400 {
		compatible = "mediatek,apcldmaout";
		reg = <0x00 0x1021b400 0x00 0x00>;
	};

	apcldmaout_ao@10014400 {
		compatible = "mediatek,apcldmaout_ao";
		reg = <0x00 0x10014400 0x00 0x400>;
	};

	apmixed@1000c000 {
		#clock-cells = <0x01>;
		compatible = "mediatek,apmixed\0syscon";
		linux,phandle = <0x43>;
		phandle = <0x43>;
		reg = <0x00 0x1000c000 0x00 0x1000>;
	};

	apxgpt@10008000 {
		clocks = <0x1d>;
		compatible = "mediatek,apxgpt";
		interrupts = <0x00 0xaa 0x08>;
		reg = <0x00 0x10008000 0x00 0x1000>;
	};

	atf_logger {
		compatible = "mediatek,atf_logger";
		interrupts = <0x00 0xf7 0x01>;
	};

	audio@11220000 {
		#clock-cells = <0x01>;
		compatible = "mediatek,audio\0syscon";
		linux,phandle = <0x42>;
		mediatek,btcvsd_snd = <0x41>;
		phandle = <0x42>;
		reg = <0x00 0x11220000 0x00 0x1000>;
	};

	audio_snd_card {
		compatible = "mediatek,audio_snd_card";
	};

	audio_sram@11221000 {
		compatible = "mediatek,audio_sram";
		reg = <0x00 0x11221000 0x00 0x9000>;
	};

	auxadc@11001000 {
		clock-names = "auxadc-main";
		clocks = <0x27 0x21>;
		compatible = "mediatek,auxadc";
		interrupts = <0x00 0x4c 0x02>;
		linux,phandle = <0x86>;
		phandle = <0x86>;
		reg = <0x00 0x11001000 0x00 0x10000>;
	};

	battery {
		CAR_TUNE_VALUE = <0x62>;
		DIFFERENCE_FULLOCV_ITH = <0xc8>;
		EMBEDDED_SEL = <0x01>;
		FG_METER_RESISTANCE = <0x4b>;
		KEEP_100_PERCENT = <0x01>;
		PMIC_MIN_VOL = <0x82dc>;
		PMIC_SHUTDOWN_CURRENT = <0x14>;
		POWERON_SYSTEM_IBOOT = <0x1f4>;
		Q_MAX_SYS_VOLTAGE_BAT0 = <0xd48>;
		Q_MAX_SYS_VOLTAGE_BAT1 = <0xd48>;
		Q_MAX_SYS_VOLTAGE_BAT2 = <0xd48>;
		Q_MAX_SYS_VOLTAGE_BAT3 = <0xd48>;
		R_FG_VALUE = <0x0a>;
		SHUTDOWN_1_TIME = <0x1e>;
		SHUTDOWN_GAUGE0_VOLTAGE = <0x84d0>;
		TEMPERATURE_T0 = <0x32>;
		TEMPERATURE_T1 = <0x19>;
		TEMPERATURE_T2 = <0x0a>;
		TEMPERATURE_T3 = <0x00>;
		TEMPERATURE_T4 = <0xfffffff6>;
		battery0_profile_t0 = <0x00 0xab04 0x3d4 0x190 0xaa64 0x3cf 0x320 0xa9d8 0x3cf 0x4af 0xa956 0x3e8 0x63f 0xa8d4 0x3cf 0x7cf 0xa85c 0x3cf 0x95f 0xa7e4 0x3cf 0xaef 0xa76c 0x3cf 0xc7e 0xa6f4 0x3cf 0xe0e 0xa67d 0x3cf 0xf9e 0xa605 0x3cf 0x112e 0xa58d 0x3cf 0x12be 0xa51f 0x3cf 0x144d 0xa4a7 0x3cf 0x15dd 0xa439 0x3e8 0x176d 0xa3c1 0x3cf 0x18fd 0xa353 0x3e8 0x1a8d 0xa2db 0x3cf 0x1c1c 0xa26d 0x3e8 0x1dac 0xa1ff 0x3e8 0x1f3c 0xa191 0x3e8 0x20cc 0xa123 0x3e8 0x225c 0xa0b5 0x3e8 0x23eb 0xa04f 0x401 0x257b 0x9fe1 0x401 0x270b 0x9f7d 0x401 0x289b 0x9f19 0x401 0x2a2b 0x9eb5 0x41a 0x2bba 0x9e51 0x41a 0x2d4a 0x9df7 0x41a 0x2eda 0x9d93 0x41a 0x306a 0x9d2f 0x41a 0x31fa 0x9cd5 0x433 0x3389 0x9c71 0x41a 0x3519 0x9c21 0x433 0x36a9 0x9bd1 0x44c 0x3839 0x9b81 0x44c 0x39c9 0x9b27 0x44c 0x3b58 0x9ad8 0x465 0x3ce8 0x9a88 0x47e 0x3e78 0x9a2e 0x47e 0x4008 0x99de 0x497 0x4198 0x998e 0x4b0 0x4327 0x9920 0x497 0x44b7 0x989e 0x44c 0x4647 0x9812 0x401 0x47d7 0x97ae 0x3e8 0x4967 0x975e 0x3e8 0x4af6 0x9718 0x3e8 0x4c86 0x96dc 0x3e8 0x4e16 0x9696 0x3cf 0x4fa6 0x9664 0x3cf 0x5135 0x9632 0x3e8 0x52c5 0x95f6 0x3cf 0x5455 0x95ce 0x3e8 0x55e5 0x959c 0x3e8 0x5775 0x956a 0x3cf 0x5904 0x9542 0x3e8 0x5a94 0x951a 0x3e8 0x5c24 0x94f2 0x3e8 0x5db4 0x94ca 0x3e8 0x5f44 0x94ac 0x401 0x60d3 0x9484 0x401 0x6263 0x9466 0x401 0x63f3 0x9448 0x401 0x6583 0x942a 0x41a 0x6713 0x940c 0x41a 0x68a2 0x93ee 0x41a 0x6a32 0x93d0 0x433 0x6bc2 0x93b2 0x433 0x6d52 0x9393 0x433 0x6ee2 0x936b 0x432 0x7071 0x9325 0x3e8 0x7201 0x92d5 0x3cf 0x7391 0x9299 0x3e8 0x7521 0x9272 0x3e8 0x76b1 0x924a 0x401 0x7840 0x9221 0x401 0x79d0 0x91f0 0x3e8 0x7b60 0x91c8 0x3e8 0x7cf0 0x91aa 0x401 0x7e80 0x9182 0x3e8 0x800f 0x9164 0x401 0x819f 0x913c 0x41a 0x832f 0x90ff 0x401 0x84bf 0x90ba 0x3e8 0x864f 0x9088 0x401 0x87de 0x904c 0x401 0x896e 0x8ffc 0x401 0x8afe 0x8fc0 0x3e8 0x8c8e 0x8fa2 0x3cf 0x8e1e 0x8fa2 0x401 0x8fad 0x8f8e 0x401 0x913d 0x8f84 0x433 0x92cd 0x8f66 0x465 0x945d 0x8f29 0x497 0x95ed 0x8e1c 0x41b 0x977c 0x8cf0 0x578 0x990c 0x8b74 0x5dd 0x9a9c 0x8b74 0x9c4>;
		battery0_profile_t0_num = <0x64>;
		battery0_profile_t1 = <0x00 0xaaaa 0x4ce 0x190 0xaa14 0x4c9 0x320 0xa99c 0x4e2 0x4af 0xa91a 0x4e2 0x63f 0xa8a2 0x4e2 0x7cf 0xa820 0x4e2 0x95f 0xa7b2 0x4fb 0xaef 0xa73a 0x4fb 0xc7e 0xa6c2 0x4e2 0xe0e 0xa64b 0x4e2 0xf9e 0xa5dd 0x4fb 0x112e 0xa565 0x4e2 0x12be 0xa4ed 0x4e2 0x144d 0xa47f 0x4e2 0x15dd 0xa407 0x4e2 0x176d 0xa399 0x4e2 0x18fd 0xa32b 0x4fb 0x1a8d 0xa2b3 0x4e2 0x1c1c 0xa245 0x4fb 0x1dac 0xa1d7 0x4fb 0x1f3c 0xa169 0x4fb 0x20cc 0xa105 0x514 0x225c 0xa097 0x514 0x23eb 0xa027 0x514 0x257b 0x9fb9 0x514 0x270b 0x9f5f 0x52d 0x289b 0x9efb 0x52d 0x2a2b 0x9eab 0x546 0x2bba 0x9e47 0x55f 0x2d4a 0x9dd9 0x55f 0x2eda 0x9d75 0x578 0x306a 0x9d07 0x578 0x31fa 0x9ca3 0x578 0x3389 0x9c49 0x591 0x3519 0x9bef 0x5aa 0x36a9 0x9b95 0x591 0x3839 0x9b46 0x5aa 0x39c9 0x9b00 0x5c3 0x3b58 0x9aba 0x5dc 0x3ce8 0x9a6a 0x5f5 0x3e78 0x9a1a 0x60e 0x4008 0x99b6 0x5dc 0x4198 0x9952 0x5dc 0x4327 0x98da 0x591 0x44b7 0x9858 0x52d 0x4647 0x97ea 0x4fb 0x47d7 0x9786 0x4c9 0x4967 0x9740 0x4e2 0x4af6 0x96fa 0x4c9 0x4c86 0x96b4 0x4b0 0x4e16 0x9682 0x4b0 0x4fa6 0x9650 0x4c9 0x5135 0x9614 0x4b0 0x52c5 0x95e2 0x4b0 0x5455 0x95ba 0x4b0 0x55e5 0x9592 0x4c9 0x5775 0x9560 0x4b0 0x5904 0x9538 0x4b0 0x5a94 0x9510 0x4c9 0x5c24 0x94f2 0x4e2 0x5db4 0x94ca 0x4c9 0x5f44 0x94ac 0x4e2 0x60d3 0x9484 0x4c9 0x6263 0x9466 0x4e2 0x63f3 0x9452 0x4fb 0x6583 0x9434 0x4fb 0x6713 0x9416 0x4fb 0x68a2 0x93f8 0x4fb 0x6a32 0x93e4 0x514 0x6bc2 0x93c6 0x514 0x6d52 0x93b2 0x514 0x6ee2 0x9393 0x514 0x7071 0x936b 0x4fa 0x7201 0x9339 0x4c9 0x7391 0x9312 0x4c9 0x7521 0x92f4 0x4c9 0x76b1 0x92cc 0x4c9 0x7840 0x92a4 0x4b0 0x79d0 0x927c 0x4b0 0x7b60 0x925e 0x4c9 0x7cf0 0x9240 0x4c9 0x7e80 0x9222 0x4e2 0x800f 0x91fa 0x4e2 0x819f 0x91c7 0x4e2 0x832f 0x9182 0x4c9 0x84bf 0x9146 0x4c9 0x864f 0x9114 0x4e2 0x87de 0x90d7 0x4e2 0x896e 0x907e 0x4e2 0x8afe 0x9042 0x4c9 0x8c8e 0x9038 0x4e2 0x8e1e 0x9024 0x4e2 0x8fad 0x901a 0x4fb 0x913d 0x9010 0x52d 0x92cd 0x8ff2 0x546 0x945d 0x8fab 0x578 0x95ed 0x8e94 0x547 0x977c 0x8dcc 0x7e9 0x990c 0x8c32 0x899 0x9a9c 0x8c32 0xf87>;
		battery0_profile_t1_num = <0x64>;
		battery0_profile_t2 = <0x00 0xaa00 0x7ee 0x190 0xa94c 0x7e9 0x320 0xa8c0 0x81b 0x4af 0xa83e 0x834 0x63f 0xa7bc 0x834 0x7cf 0xa744 0x834 0x95f 0xa6cc 0x834 0xaef 0xa654 0x834 0xc7e 0xa5e6 0x84d 0xe0e 0xa56f 0x84d 0xf9e 0xa4f7 0x834 0x112e 0xa489 0x84d 0x12be 0xa411 0x84d 0x144d 0xa3a3 0x866 0x15dd 0xa335 0x87f 0x176d 0xa2bd 0x866 0x18fd 0xa24f 0x866 0x1a8d 0xa1e1 0x87f 0x1c1c 0xa17d 0x898 0x1dac 0xa105 0x87f 0x1f3c 0xa0a1 0x898 0x20cc 0xa033 0x8b1 0x225c 0x9fcf 0x8b1 0x23eb 0x9f73 0x8ca 0x257b 0x9f19 0x8e4 0x270b 0x9ec9 0x92e 0x289b 0x9e65 0x947 0x2a2b 0x9df6 0x946 0x2bba 0x9d60 0x915 0x2d4a 0x9cd5 0x915 0x2eda 0x9c67 0x92e 0x306a 0x9c0d 0x947 0x31fa 0x9bc7 0x960 0x3389 0x9b81 0x960 0x3519 0x9b3b 0x979 0x36a9 0x9ae1 0x960 0x3839 0x9a9b 0x979 0x39c9 0x9a4b 0x979 0x3b58 0x99fb 0x979 0x3ce8 0x998d 0x92e 0x3e78 0x991f 0x915 0x4008 0x989d 0x8ca 0x4198 0x9826 0x866 0x4327 0x97c2 0x834 0x44b7 0x9772 0x834 0x4647 0x9722 0x802 0x47d7 0x96dc 0x802 0x4967 0x96a0 0x802 0x4af6 0x966e 0x802 0x4c86 0x963c 0x81b 0x4e16 0x9600 0x802 0x4fa6 0x95d8 0x834 0x5135 0x95a6 0x81b 0x52c5 0x9574 0x81b 0x5455 0x9556 0x834 0x55e5 0x9524 0x834 0x5775 0x9506 0x84d 0x5904 0x94de 0x84d 0x5a94 0x94b6 0x84d 0x5c24 0x9498 0x866 0x5db4 0x947a 0x87f 0x5f44 0x945c 0x87f 0x60d3 0x943e 0x87f 0x6263 0x9420 0x87f 0x63f3 0x940c 0x898 0x6583 0x93ee 0x898 0x6713 0x93d0 0x898 0x68a2 0x93bc 0x8b1 0x6a32 0x93a8 0x8ca 0x6bc2 0x9394 0x8ca 0x6d52 0x9380 0x8ca 0x6ee2 0x936c 0x8ca 0x7071 0x9358 0x8e3 0x7201 0x9339 0x8e3 0x7391 0x9311 0x8e3 0x7521 0x92ea 0x8e3 0x76b1 0x92c2 0x8e3 0x7840 0x92a4 0x8fc 0x79d0 0x927c 0x8fd 0x7b60 0x925d 0x92e 0x7cf0 0x922b 0x92e 0x7e80 0x91ef 0x947 0x800f 0x91b3 0x960 0x819f 0x9178 0x979 0x832f 0x913b 0x992 0x84bf 0x90f5 0x9ab 0x864f 0x909c 0x9c4 0x87de 0x9074 0xa0f 0x896e 0x9056 0xa29 0x8afe 0x904c 0xa8d 0x8c8e 0x9038 0xaf1 0x8e1e 0x901a 0xb6e 0x8fad 0x8ff2 0xc04 0x913d 0x8f83 0xce4 0x92cd 0x8e1b 0xd62 0x945d 0x8c09 0xec0 0x95ed 0x892f 0x109d 0x977c 0x8660 0x178a 0x990c 0x84bc 0x1d33 0x9a9c 0x84bc 0x1d4c>;
		battery0_profile_t2_num = <0x64>;
		battery0_profile_t3 = <0x00 0xa8c0 0xe2e 0x190 0xa7da 0xe29 0x320 0xa73a 0xe8d 0x4af 0xa6ae 0xed8 0x63f 0xa636 0xf0a 0x7cf 0xa5b4 0xef1 0x95f 0xa53c 0xf0a 0xaef 0xa4c4 0xf55 0xc7e 0xa44c 0xf23 0xe0e 0xa3df 0xf3c 0xf9e 0xa371 0xf55 0x112e 0xa2f9 0xf6e 0x12be 0xa28b 0xf87 0x144d 0xa21d 0xf87 0x15dd 0xa1b9 0xfb9 0x176d 0xa141 0xf87 0x18fd 0xa0dd 0xfa0 0x1a8d 0xa06f 0xfa0 0x1c1c 0xa00b 0xfd2 0x1dac 0x9fa7 0xfeb 0x1f3c 0x9f57 0x1035 0x20cc 0x9f07 0x1067 0x225c 0x9ead 0x1068 0x23eb 0x9e32 0x104f 0x257b 0x9d9c 0x104e 0x270b 0x9cfc 0x101d 0x289b 0x9c71 0x101d 0x2a2b 0x9c03 0x1037 0x2bba 0x9ba9 0x1069 0x2d4a 0x9b63 0x109a 0x2eda 0x9b1d 0x109a 0x306a 0x9ae1 0x1081 0x31fa 0x9a91 0x1068 0x3389 0x9a4b 0x1068 0x3519 0x99f1 0x104f 0x36a9 0x9997 0x104f 0x3839 0x9929 0x101c 0x39c9 0x98b1 0xfd2 0x3b58 0x9843 0xfa0 0x3ce8 0x97d6 0xf55 0x3e78 0x977c 0xf0a 0x4008 0x972c 0xf0a 0x4198 0x96e6 0xf23 0x4327 0x96aa 0xf3c 0x44b7 0x966e 0xf55 0x4647 0x9632 0xf23 0x47d7 0x9600 0xf6e 0x4967 0x95ce 0xf3c 0x4af6 0x959c 0xf87 0x4c86 0x9574 0xfb9 0x4e16 0x9542 0xf6e 0x4fa6 0x951a 0xfb9 0x5135 0x94fc 0xfd2 0x52c5 0x94d4 0x1004 0x5455 0x94ac 0x1004 0x55e5 0x948e 0x1004 0x5775 0x9470 0x104f 0x5904 0x9452 0x104f 0x5a94 0x9434 0x104f 0x5c24 0x9416 0x1068 0x5db4 0x93f8 0x109a 0x5f44 0x93ee 0x10e5 0x60d3 0x93da 0x1117 0x6263 0x93d0 0x1161 0x63f3 0x93bc 0x1162 0x6583 0x93b2 0x1194 0x6713 0x939e 0x11ad 0x68a2 0x938a 0x11c6 0x6a32 0x9380 0x1210 0x6bc2 0x9362 0x122b 0x6d52 0x9344 0x125d 0x6ee2 0x9326 0x128f 0x7071 0x9307 0x12f3 0x7201 0x92df 0x1325 0x7391 0x92b7 0x1357 0x7521 0x928f 0x13bb 0x76b1 0x925d 0x1406 0x7840 0x922b 0x146a 0x79d0 0x91ef 0x14e7 0x7b60 0x91a9 0x154c 0x7cf0 0x9177 0x1613 0x7e80 0x9131 0x16aa 0x800f 0x90e1 0x1771 0x819f 0x9092 0x1808 0x832f 0x906a 0x1902 0x84bf 0x904c 0x19fc 0x864f 0x902e 0x1b0f 0x87de 0x9010 0x1c6e 0x896e 0x8ff2 0x1e62 0x8afe 0x8fa1 0x20bb 0x8c8e 0x8eec 0x2376 0x8e1e 0x8d52 0x2666 0x8fad 0x8af9 0x2b4b 0x913d 0x87c4 0x3396 0x92cd 0x82b0 0x3548 0x945d 0x7ecc 0x2c0b 0x95ed 0x7ecc 0x2c0b 0x977c 0x7ecc 0x2c0b 0x990c 0x7ecc 0x2c0b 0x9a9c 0x7ecc 0x2c0b>;
		battery0_profile_t3_num = <0x64>;
		battery0_profile_t4 = <0x00 0xa7c6 0x1d38 0x190 0xa6fe 0x1d33 0x320 0xa60e 0x1e2d 0x4af 0xa4ec 0x1eaa 0x63f 0xa3e9 0x2020 0x7cf 0xa348 0x2133 0x95f 0xa2c6 0x21ca 0xaef 0xa244 0x21b1 0xc7e 0xa1cc 0x2215 0xe0e 0xa155 0x21ca 0xf9e 0xa0e7 0x222d 0x112e 0xa079 0x21e3 0x12be 0xa015 0x225f 0x144d 0x9fbb 0x222e 0x15dd 0x9f61 0x22c3 0x176d 0x9efd 0x2292 0x18fd 0x9e85 0x2248 0x1a8d 0x9df9 0x2279 0x1c1c 0x9d59 0x2247 0x1dac 0x9cb0 0x21cb 0x1f3c 0x9c23 0x21fb 0x20cc 0x9bab 0x21cb 0x225c 0x9b33 0x222d 0x23eb 0x9acd 0x2215 0x257b 0x9a73 0x21fd 0x270b 0x9a19 0x2245 0x289b 0x99b5 0x21c9 0x2a2b 0x995b 0x2198 0x2bba 0x98f7 0x21b0 0x2d4a 0x989d 0x2134 0x2eda 0x9839 0x214d 0x306a 0x97e9 0x211b 0x31fa 0x9799 0x2103 0x3389 0x9753 0x214c 0x3519 0x970d 0x2102 0x36a9 0x96c8 0x2135 0x3839 0x968c 0x2198 0x39c9 0x965a 0x2198 0x3b58 0x961e 0x21b1 0x3ce8 0x95ec 0x2199 0x3e78 0x95ba 0x21fc 0x4008 0x9588 0x21fc 0x4198 0x9560 0x21fc 0x4327 0x952e 0x2260 0x44b7 0x9506 0x2292 0x4647 0x94de 0x2260 0x47d7 0x94b6 0x22c4 0x4967 0x9498 0x2328 0x4af6 0x947a 0x22f6 0x4c86 0x945c 0x23a5 0x4e16 0x9448 0x23be 0x4fa6 0x942a 0x23d7 0x5135 0x9416 0x2486 0x52c5 0x9402 0x24d1 0x5455 0x93ee 0x24d1 0x55e5 0x93da 0x2580 0x5775 0x93c6 0x25fd 0x5904 0x93b2 0x262f 0x5a94 0x9394 0x26f6 0x5c24 0x9380 0x2742 0x5db4 0x9362 0x278d 0x5f44 0x9344 0x286d 0x60d3 0x931c 0x2887 0x6263 0x92f4 0x2935 0x63f3 0x92d6 0x2980 0x6583 0x92a4 0x2a79 0x6713 0x9272 0x2af7 0x68a2 0x9237 0x2ba5 0x6a32 0x9204 0x2c6d 0x6bc2 0x91c9 0x2d1c 0x6d52 0x918d 0x2e15 0x6ee2 0x9147 0x2f28 0x7071 0x9101 0x3054 0x7201 0x90c5 0x311d 0x7391 0x9093 0x30f7 0x7521 0x9075 0x30a7 0x76b1 0x9058 0x305b 0x7840 0x9037 0x3024 0x79d0 0x8ff9 0x35ac 0x7b60 0x8f95 0x3b5a 0x7cf0 0x8eda 0x3e13 0x7e80 0x8d7a 0x3f86 0x800f 0x8b4d 0x416a 0x819f 0x884c 0x4206 0x832f 0x83ac 0x37d7 0x84bf 0x7c92 0x26de 0x864f 0x7c92 0x26de 0x87de 0x7c92 0x26de 0x896e 0x7c92 0x26de 0x8afe 0x7c92 0x26de 0x8c8e 0x7c92 0x26de 0x8e1e 0x7c92 0x26de 0x8fad 0x7c92 0x26de 0x913d 0x7c92 0x26de 0x92cd 0x7c92 0x26de 0x945d 0x7c92 0x26de 0x95ed 0x7c92 0x26de 0x977c 0x7c92 0x26de 0x990c 0x7c92 0x26de 0x9a9c 0x7c92 0x26de>;
		battery0_profile_t4_num = <0x64>;
		battery1_profile_t0 = <0x00 0xaae6 0x3e8 0x194 0xaa3a 0x401 0x328 0xa999 0x401 0x4bc 0xa90c 0x401 0x64f 0xa889 0x401 0x7e3 0xa806 0x401 0x977 0xa783 0x401 0xb0b 0xa70a 0x401 0xc9f 0xa691 0x401 0xe33 0xa618 0x401 0xfc6 0xa59f 0x401 0x115a 0xa52f 0x401 0x12ee 0xa4b6 0x3fe 0x1482 0xa43e 0x3eb 0x1616 0xa3cf 0x401 0x17aa 0xa35f 0x401 0x193d 0xa2e7 0x401 0x1ad1 0xa278 0x401 0x1c65 0xa209 0x401 0x1df9 0xa19a 0x406 0x1f8d 0xa12b 0x415 0x2121 0xa0bc 0x401 0x22b4 0xa051 0x40c 0x2448 0x9fef 0x42d 0x25dc 0x9f82 0x41a 0x2770 0x9f1e 0x421 0x2904 0x9eb9 0x42c 0x2a98 0x9e54 0x421 0x2c2b 0x9df2 0x433 0x2dbf 0x9d94 0x433 0x2f53 0x9d32 0x43b 0x30e7 0x9cd7 0x44c 0x327b 0x9c7c 0x44c 0x340f 0x9c25 0x44c 0x35a3 0x9bd4 0x455 0x3736 0x9b80 0x465 0x38ca 0x9b28 0x465 0x3a5e 0x9ad8 0x46f 0x3bf2 0x9a87 0x47e 0x3d86 0x9a3a 0x492 0x3f1a 0x99ef 0x4ba 0x40ad 0x999a 0x4c9 0x4241 0x993b 0x4be 0x43d5 0x98cd 0x49a 0x4569 0x9850 0x45c 0x46fd 0x97d6 0x428 0x4891 0x9770 0x40e 0x4a24 0x971f 0x401 0x4bb8 0x96d8 0x3f5 0x4d4c 0x969b 0x3f4 0x4ee0 0x9664 0x401 0x5074 0x962c 0x401 0x5208 0x95fa 0x401 0x539b 0x95c7 0x401 0x552f 0x9595 0x401 0x56c3 0x9568 0x401 0x5857 0x953a 0x3f3 0x59eb 0x950d 0x3e8 0x5b7f 0x94eb 0x3f7 0x5d12 0x94c6 0x410 0x5ea6 0x94a4 0x429 0x603a 0x9480 0x424 0x61ce 0x945d 0x429 0x6362 0x9439 0x423 0x64f6 0x941d 0x42a 0x6689 0x9403 0x443 0x681d 0x93e4 0x44c 0x69b1 0x93c6 0x44c 0x6b45 0x93ae 0x45d 0x6cd9 0x938c 0x453 0x6e6d 0x936a 0x44c 0x7001 0x932f 0x427 0x7194 0x92e8 0x407 0x7328 0x92a1 0x401 0x74bc 0x9272 0x401 0x7650 0x9249 0x414 0x77e4 0x9219 0x407 0x7978 0x91ee 0x401 0x7b0b 0x91c6 0x401 0x7c9f 0x91a6 0x415 0x7e33 0x917f 0x41a 0x7fc7 0x915f 0x42f 0x815b 0x9130 0x41e 0x82ef 0x90f5 0x41a 0x8482 0x90b0 0x405 0x8616 0x907b 0x417 0x87aa 0x9037 0x41a 0x893e 0x8fe7 0x41a 0x8ad2 0x8fa8 0x404 0x8c66 0x8f99 0x418 0x8df9 0x8f8f 0x431 0x8f8d 0x8f85 0x44a 0x9121 0x8f7b 0x47b 0x92b5 0x8f5e 0x496 0x9449 0x8f19 0x4af 0x95dd 0x8e12 0x468 0x9770 0x8c5d 0x47d 0x9904 0x8a0d 0x4c8 0x9a98 0x86ea 0x513 0x9c2c 0x86e2 0x125c>;
		battery1_profile_t0_num = <0x64>;
		battery1_profile_t1 = <0x00 0xaa82 0x5aa 0x194 0xa9d7 0x5c3 0x328 0xa94a 0x5dc 0x4bc 0xa8c6 0x5dc 0x64f 0xa843 0x5dd 0x7e3 0xa7ca 0x5f5 0x977 0xa751 0x5f4 0xb0b 0xa6d7 0x5da 0xc9f 0xa656 0x5c3 0xe33 0xa5e6 0x5c3 0xfc6 0xa56d 0x5c3 0x115a 0xa4fd 0x5c0 0x12ee 0xa485 0x5ad 0x1482 0xa416 0x5c3 0x1616 0xa3a7 0x5c3 0x17aa 0xa337 0x5c3 0x193d 0xa2bf 0x5c3 0x1ad1 0xa250 0x5bf 0x1c65 0xa1e1 0x5aa 0x1df9 0xa174 0x5af 0x1f8d 0xa10d 0x5c3 0x2121 0xa0a0 0x5c8 0x22b4 0xa038 0x5d7 0x2448 0x9fc9 0x5c9 0x25dc 0x9f64 0x5dc 0x2770 0x9f02 0x5e3 0x2904 0x9ea7 0x5f5 0x2a98 0x9e4a 0x5f5 0x2c2b 0x9de5 0x5fc 0x2dbf 0x9d7a 0x606 0x2f53 0x9d07 0x5f5 0x30e7 0x9ca5 0x5fd 0x327b 0x9c4d 0x61f 0x340f 0x9bfd 0x640 0x35a3 0x9bac 0x640 0x3736 0x9b5f 0x649 0x38ca 0x9b14 0x662 0x3a5e 0x9ac4 0x672 0x3bf2 0x9a73 0x672 0x3d86 0x9a1e 0x672 0x3f1a 0x99c3 0x672 0x40ad 0x9964 0x65d 0x4241 0x98ff 0x635 0x43d5 0x9891 0x606 0x4569 0x9818 0x5ba 0x46fd 0x97ad 0x586 0x4891 0x9757 0x56c 0x4a24 0x9706 0x547 0x4bb8 0x96bf 0x539 0x4d4c 0x9682 0x53a 0x4ee0 0x964b 0x52d 0x5074 0x9618 0x53a 0x5208 0x95e6 0x546 0x539b 0x95b3 0x539 0x552f 0x9586 0x53b 0x56c3 0x955e 0x546 0x5857 0x9536 0x546 0x59eb 0x950d 0x546 0x5b7f 0x94e5 0x546 0x5d12 0x94c2 0x555 0x5ea6 0x949e 0x55f 0x603a 0x9482 0x56e 0x61ce 0x9461 0x569 0x6362 0x943f 0x55f 0x64f6 0x9427 0x57f 0x6689 0x940d 0x591 0x681d 0x93ee 0x591 0x69b1 0x93d7 0x591 0x6b45 0x93bb 0x591 0x6cd9 0x939d 0x591 0x6e6d 0x9386 0x591 0x7001 0x9363 0x57f 0x7194 0x9342 0x578 0x7328 0x931c 0x565 0x74bc 0x92f4 0x54c 0x7650 0x92d3 0x559 0x77e4 0x92ad 0x55f 0x7978 0x9284 0x55f 0x7b0b 0x925c 0x55f 0x7c9f 0x923c 0x55f 0x7e33 0x921d 0x573 0x7fc7 0x91ef 0x578 0x815b 0x91bc 0x578 0x82ef 0x9181 0x58d 0x8482 0x9145 0x591 0x8616 0x9108 0x5a7 0x87aa 0x90c3 0x5aa 0x893e 0x906a 0x5aa 0x8ad2 0x9033 0x5aa 0x8c66 0x901c 0x5c1 0x8df9 0x9011 0x5f1 0x8f8d 0x8ffe 0x60c 0x9121 0x8fe9 0x66b 0x92b5 0x8fcc 0x6d0 0x9449 0x8f7e 0x735 0x95dd 0x8e8a 0x722 0x9770 0x8cb8 0x752 0x9904 0x8a4a 0x7e6 0x9a98 0x86e0 0x8c8 0x9c2c 0x86d8 0x194b>;
		battery1_profile_t1_num = <0x64>;
		battery1_profile_t2 = <0x00 0xa9b0 0x91a 0x194 0xa8d3 0xb3d 0x328 0xa83b 0xbea 0x4bc 0xa7a4 0xbd3 0x64f 0xa721 0xc1b 0x7e3 0xa6a8 0xc04 0x977 0xa626 0xc1b 0xb0b 0xa5b6 0xc05 0xc9f 0xa53d 0xc18 0xe33 0xa4c4 0xbea 0xfc6 0xa44b 0xbec 0x115a 0xa3dc 0xc00 0x12ee 0xa36d 0xbea 0x1482 0xa2fe 0xbea 0x1616 0xa28f 0xbea 0x17aa 0xa220 0xbea 0x193d 0xa1b1 0xbe6 0x1ad1 0xa142 0xbd1 0x1c65 0xa0d5 0xbd5 0x1df9 0xa06e 0xbe5 0x1f8d 0xa001 0xbd6 0x2121 0x9f9e 0xbef 0x22b4 0x9f45 0xc0e 0x2448 0x9ef0 0xc3b 0x25dc 0x9e92 0xc4e 0x2770 0x9e28 0xc47 0x2904 0x9dac 0xc27 0x2a98 0x9d29 0xbfc 0x2c2b 0x9cac 0xbea 0x2dbf 0x9c40 0xbe2 0x2f53 0x9be4 0xbe1 0x30e7 0x9b9a 0xc03 0x327b 0x9b50 0xc14 0x340f 0x9b10 0xc3e 0x35a3 0x9ac9 0xc57 0x3736 0x9a7f 0xc67 0x38ca 0x9a2e 0xc67 0x3a5e 0x99da 0xc54 0x3bf2 0x9977 0xc18 0x3d86 0x9908 0xbd6 0x3f1a 0x9895 0xb99 0x40ad 0x9820 0xb4e 0x4241 0x97b5 0xb0d 0x43d5 0x9759 0xaf0 0x4569 0x9708 0xae5 0x46fd 0x96c1 0xae2 0x4891 0x967f 0xad9 0x4a24 0x9642 0xabe 0x4bb8 0x9610 0xaca 0x4d4c 0x95dd 0xae3 0x4ee0 0x95ab 0xaf0 0x5074 0x957d 0xaf0 0x5208 0x9550 0xafd 0x539b 0x9523 0xb16 0x552f 0x94fa 0xb14 0x56c3 0x94d7 0xb25 0x5857 0x94b4 0xb49 0x59eb 0x948b 0xb46 0x5b7f 0x9469 0xb58 0x5d12 0x9450 0xb8b 0x5ea6 0x9436 0xbae 0x603a 0x9418 0xba9 0x61ce 0x93f9 0xbae 0x6362 0x93e1 0xbc8 0x64f6 0x93cd 0xbe1 0x6689 0x93b9 0xbfa 0x681d 0x93a5 0xc03 0x69b1 0x9391 0xc24 0x6b45 0x937c 0xc35 0x6cd9 0x9368 0xc59 0x6e6d 0x9354 0xc8b 0x7001 0x9338 0xcab 0x7194 0x931a 0xcc5 0x7328 0x92fb 0xd03 0x74bc 0x92d6 0xd29 0x7650 0x92ad 0xd7c 0x77e4 0x9285 0xdba 0x7978 0x925c 0xe00 0x7b0b 0x922c 0xe4c 0x7c9f 0x91fa 0xeac 0x7e33 0x91bf 0xf11 0x7fc7 0x917a 0xf76 0x815b 0x9133 0xfc6 0x82ef 0x90ed 0x1051 0x8482 0x90a6 0x10d3 0x8616 0x9071 0x1167 0x87aa 0x903e 0x122a 0x893e 0x9015 0x134c 0x8ad2 0x8fec 0x147b 0x8c66 0x8fbb 0x1605 0x8df9 0x8f76 0x173d 0x8f8d 0x8f14 0x18c8 0x9121 0x8e64 0x1a16 0x92b5 0x8d18 0x1b5e 0x9449 0x8b02 0x1d1d 0x95dd 0x8804 0x2125 0x9770 0x834f 0x289b 0x9904 0x7bca 0x243b 0x9a98 0x7bca 0x243b 0x9c2c 0x7bca 0x243b>;
		battery1_profile_t2_num = <0x64>;
		battery1_profile_t3 = <0x00 0xa870 0x1054 0x194 0xa76a 0x1691 0x328 0xa6ab 0x178c 0x4bc 0xa614 0x1820 0x64f 0xa57d 0x1838 0x7e3 0xa4f0 0x183c 0x977 0xa46d 0x1882 0xb0b 0xa3f3 0x186d 0xc9f 0xa372 0x189c 0xe33 0xa302 0x1896 0xfc6 0xa288 0x1856 0x115a 0xa210 0x187e 0x12ee 0xa1a1 0x1857 0x1482 0xa132 0x1880 0x1616 0xa0c3 0x1867 0x17aa 0xa056 0x1855 0x193d 0x9ff2 0x1866 0x1ad1 0x9f97 0x185d 0x1c65 0x9f3b 0x1898 0x1df9 0x9ed4 0x1883 0x1f8d 0x9e61 0x187e 0x2121 0x9dde 0x185b 0x22b4 0x9d58 0x180f 0x2448 0x9ccd 0x17ce 0x25dc 0x9c58 0x17c1 0x2770 0x9bf6 0x17db 0x2904 0x9b9e 0x17ed 0x2a98 0x9b50 0x17f4 0x2c2b 0x9b09 0x180d 0x2dbf 0x9ac0 0x181f 0x2f53 0x9a72 0x181f 0x30e7 0x9a28 0x1817 0x327b 0x99d7 0x17fe 0x340f 0x9983 0x17dc 0x35a3 0x9925 0x17a9 0x3736 0x98c0 0x176e 0x38ca 0x9857 0x172b 0x3a5e 0x97ec 0x16f9 0x3bf2 0x9787 0x16bd 0x3d86 0x9726 0x167b 0x3f1a 0x96d3 0x165d 0x40ad 0x968d 0x165d 0x4241 0x9646 0x1652 0x43d5 0x9608 0x1665 0x4569 0x95d1 0x168f 0x46fd 0x959e 0x168f 0x4891 0x9571 0x16a6 0x4a24 0x9543 0x16d9 0x4bb8 0x951b 0x16e7 0x4d4c 0x94ed 0x16da 0x4ee0 0x94c5 0x170c 0x5074 0x94a1 0x1724 0x5208 0x947e 0x1740 0x539b 0x9460 0x1770 0x552f 0x9442 0x177e 0x56c3 0x9429 0x1797 0x5857 0x9415 0x17be 0x59eb 0x9401 0x17ff 0x5b7f 0x93f2 0x1859 0x5d12 0x93e2 0x18be 0x5ea6 0x93d4 0x1905 0x603a 0x93c4 0x1947 0x61ce 0x93b0 0x1992 0x6362 0x93a2 0x19ee 0x64f6 0x9391 0x1a63 0x6689 0x937d 0x1af1 0x681d 0x9362 0x1b78 0x69b1 0x9344 0x1be6 0x6b45 0x9325 0x1c6f 0x6cd9 0x9307 0x1cf6 0x6e6d 0x92e1 0x1d74 0x7001 0x92b9 0x1e17 0x7194 0x9290 0x1eda 0x7328 0x9260 0x1fa4 0x74bc 0x9226 0x2048 0x7650 0x91f2 0x20f3 0x77e4 0x91b7 0x21a3 0x7978 0x917b 0x22b7 0x7b0b 0x913e 0x23aa 0x7c9f 0x910a 0x24c9 0x7e33 0x90cf 0x2621 0x7fc7 0x9092 0x276e 0x815b 0x9056 0x291f 0x82ef 0x9019 0x2abb 0x8482 0x8fdd 0x2ca4 0x8616 0x8f97 0x2e46 0x87aa 0x8f48 0x3006 0x893e 0x8edd 0x320f 0x8ad2 0x8e4a 0x336e 0x8c66 0x8d6a 0x3445 0x8df9 0x8c1d 0x3526 0x8f8d 0x8a17 0x36c1 0x9121 0x86d5 0x3a9e 0x92b5 0x80f0 0x30f9 0x9449 0x7a76 0x2134 0x95dd 0x7a76 0x2134 0x9770 0x7a76 0x2134 0x9904 0x7a76 0x2134 0x9a98 0x7a76 0x2134 0x9c2c 0x7a76 0x2134>;
		battery1_profile_t3_num = <0x64>;
		battery1_profile_t4 = <0x00 0xa7bc 0x1cb6 0x194 0xa6c9 0x1b51 0x328 0xa5d0 0x1c41 0x4bc 0xa4b6 0x1d66 0x64f 0xa377 0x1ecc 0x7e3 0xa258 0x21a5 0x977 0xa184 0x2457 0xb0b 0xa0d1 0x2535 0xc9f 0xa030 0x25a6 0xe33 0x9f92 0x25f9 0xfc6 0x9ee9 0x260f 0x115a 0x9e48 0x25ed 0x12ee 0x9d99 0x25fd 0x1482 0x9ce2 0x25fd 0x1616 0x9c2a 0x25e4 0x17aa 0x9b79 0x25c6 0x193d 0x9ad7 0x25b2 0x1ad1 0x9a46 0x2592 0x1c65 0x99bd 0x256b 0x1df9 0x9942 0x2569 0x1f8d 0x98d4 0x2579 0x2121 0x986d 0x2573 0x22b4 0x980b 0x256e 0x2448 0x97b3 0x2596 0x25dc 0x975f 0x259c 0x2770 0x9709 0x25c4 0x2904 0x96b9 0x2601 0x2a98 0x9671 0x2629 0x2c2b 0x9628 0x2648 0x2dbf 0x95e2 0x2658 0x2f53 0x95a6 0x26b2 0x30e7 0x9562 0x26ce 0x327b 0x9521 0x26c5 0x340f 0x94e5 0x26e1 0x35a3 0x94a8 0x271e 0x3736 0x9470 0x275b 0x38ca 0x9439 0x2774 0x3a5e 0x93fc 0x278b 0x3bf2 0x93c0 0x27cd 0x3d86 0x9389 0x281a 0x3f1a 0x9346 0x2818 0x40ad 0x9309 0x2871 0x4241 0x92c2 0x28d2 0x43d5 0x926e 0x293b 0x4569 0x9219 0x29f2 0x46fd 0x91be 0x2aa7 0x4891 0x9155 0x2b5d 0x4a24 0x90fc 0x2c7b 0x4bb8 0x90b9 0x2d6e 0x4d4c 0x9089 0x2ea7 0x4ee0 0x9058 0x3065 0x5074 0x900b 0x3218 0x5208 0x8f47 0x3437 0x539b 0x8d4a 0x35f4 0x552f 0x89aa 0x386c 0x56c3 0x82fe 0x3d58 0x5857 0x7300 0x11f67 0x59eb 0x7300 0x11f67 0x5b7f 0x7300 0x11f67 0x5d12 0x7300 0x11f67 0x5ea6 0x7300 0x11f67 0x603a 0x7300 0x11f67 0x61ce 0x7300 0x11f67 0x6362 0x7300 0x11f67 0x64f6 0x7300 0x11f67 0x6689 0x7300 0x11f67 0x681d 0x7300 0x11f67 0x69b1 0x7300 0x11f67 0x6b45 0x7300 0x11f67 0x6cd9 0x7300 0x11f67 0x6e6d 0x7300 0x11f67 0x7001 0x7300 0x11f67 0x7194 0x7300 0x11f67 0x7328 0x7300 0x11f67 0x74bc 0x7300 0x11f67 0x7650 0x7300 0x11f67 0x77e4 0x7300 0x11f67 0x7978 0x7300 0x11f67 0x7b0b 0x7300 0x11f67 0x7c9f 0x7300 0x11f67 0x7e33 0x7300 0x11f67 0x7fc7 0x7300 0x11f67 0x815b 0x7300 0x11f67 0x82ef 0x7300 0x11f67 0x8482 0x7300 0x11f67 0x8616 0x7300 0x11f67 0x87aa 0x7300 0x11f67 0x893e 0x7300 0x11f67 0x8ad2 0x7300 0x11f67 0x8c66 0x7300 0x11f67 0x8df9 0x7300 0x11f67 0x8f8d 0x7300 0x11f67 0x9121 0x7300 0x11f67 0x92b5 0x7300 0x11f67 0x9449 0x7300 0x11f67 0x95dd 0x7300 0x11f67 0x9770 0x7300 0x11f67 0x9904 0x7300 0x11f67 0x9a98 0x7300 0x11f67 0x9c2c 0x7300 0x11f67>;
		battery1_profile_t4_num = <0x64>;
		compatible = "mediatek,bat_gm30";
		g_FG_PSEUDO100_T0 = <0x64>;
		g_FG_PSEUDO100_T1 = <0x62>;
		g_FG_PSEUDO100_T2 = <0x5d>;
		g_FG_PSEUDO100_T3 = <0x5d>;
		g_FG_PSEUDO100_T4 = <0x5c>;
		linux,phandle = <0x83>;
		phandle = <0x83>;
	};

	bpi_bsi_slv0@1021e000 {
		compatible = "mediatek,bpi_bsi_slv0";
		reg = <0x00 0x1021e000 0x00 0x1000>;
	};

	bpi_bsi_slv1@1021f000 {
		compatible = "mediatek,bpi_bsi_slv1";
		reg = <0x00 0x1021f000 0x00 0x6000>;
	};

	bpi_bsi_slv2@10225000 {
		compatible = "mediatek,bpi_bsi_slv2";
		reg = <0x00 0x10225000 0x00 0x1000>;
	};

	btif@1100c000 {
		clock-names = "btifc\0apdmac";
		clocks = <0x27 0x1a 0x27 0x26>;
		compatible = "mediatek,btif";
		interrupts = <0x00 0x70 0x08 0x00 0x84 0x08 0x00 0x85 0x08>;
		reg = <0x00 0x1100c000 0x00 0x1000 0x00 0x11000880 0x00 0x80 0x00 0x11000900 0x00 0x80>;
	};

	bus_dbg@10208000 {
		compatible = "mediatek,bus_dbg-v2";
		interrupts = <0x00 0x8d 0x08>;
		mediatek,bus_dbg_con_offset = <0x2fc>;
		reg = <0x00 0x10208000 0x00 0x1000 0x00 0x10001000 0x00 0x1000>;
	};

	cam1@1a003000 {
		compatible = "mediatek,cam1";
		interrupts = <0x00 0xeb 0x08>;
		reg = <0x00 0x1a003000 0x00 0x1000>;
	};

	cam2@1a004000 {
		compatible = "mediatek,cam2";
		interrupts = <0x00 0xec 0x08>;
		reg = <0x00 0x1a004000 0x00 0x1000>;
	};

	cam3@1a005000 {
		compatible = "mediatek,cam3";
		interrupts = <0x00 0xed 0x08>;
		reg = <0x00 0x1a005000 0x00 0x1000>;
	};

	cam_clear@1a01b000 {
		compatible = "mediatek,cam_clear";
		reg = <0x00 0x1a01b000 0x00 0x1000>;
	};

	cam_inner@1a013000 {
		compatible = "mediatek,cam_inner";
		reg = <0x00 0x1a013000 0x00 0x1000>;
	};

	cam_set@1a00b000 {
		compatible = "mediatek,cam_set";
		reg = <0x00 0x1a00b000 0x00 0x1000>;
	};

	cama_clear@1a01c000 {
		compatible = "mediatek,cama_clear";
		reg = <0x00 0x1a01c000 0x00 0x1000>;
	};

	cama_ext@1a024000 {
		compatible = "mediatek,cama_ext";
		reg = <0x00 0x1a024000 0x00 0x1000>;
	};

	cama_inner@1a014000 {
		compatible = "mediatek,cama_inner";
		reg = <0x00 0x1a014000 0x00 0x1000>;
	};

	cama_set@1a00c000 {
		compatible = "mediatek,cama_set";
		reg = <0x00 0x1a00c000 0x00 0x1000>;
	};

	camb_clear@1a01d000 {
		compatible = "mediatek,camb_clear";
		reg = <0x00 0x1a01d000 0x00 0x1000>;
	};

	camb_ext@1a025000 {
		compatible = "mediatek,camb_ext";
		reg = <0x00 0x1a025000 0x00 0x1000>;
	};

	camb_inner@1a015000 {
		compatible = "mediatek,camb_inner";
		reg = <0x00 0x1a015000 0x00 0x1000>;
	};

	camb_set@1a00d000 {
		compatible = "mediatek,camb_set";
		reg = <0x00 0x1a00d000 0x00 0x1000>;
	};

	camsv1@1a050000 {
		compatible = "mediatek,camsv1";
		interrupts = <0x00 0xf3 0x08>;
		reg = <0x00 0x1a050000 0x00 0x1000>;
	};

	camsv2@1a051000 {
		compatible = "mediatek,camsv2";
		interrupts = <0x00 0xf4 0x08>;
		reg = <0x00 0x1a051000 0x00 0x1000>;
	};

	camsv3@1a052000 {
		compatible = "mediatek,camsv3";
		interrupts = <0x00 0xf1 0x08>;
		reg = <0x00 0x1a052000 0x00 0x1000>;
	};

	camsv4@1a053000 {
		compatible = "mediatek,camsv4";
		interrupts = <0x00 0xf2 0x08>;
		reg = <0x00 0x1a053000 0x00 0x1000>;
	};

	camsys@1a000000 {
		#clock-cells = <0x01>;
		compatible = "mediatek,camsys\0syscon";
		linux,phandle = <0x45>;
		phandle = <0x45>;
		reg = <0x00 0x1a000000 0x00 0x1000>;
	};

	ccu@1a0b0000 {
		clock-names = "CCU_CLK_CAM_CCU";
		clocks = <0x45 0x08>;
		compatible = "mediatek,ccu";
		interrupts = <0x00 0xf6 0x08>;
		reg = <0x00 0x1a0b1000 0x00 0x1000>;
	};

	charger {
		ac_charger_current = <0x1f47d0>;
		ac_charger_input_current = <0x1e8480>;
		algorithm_name = "SwitchCharging";
		apple_1_0a_charger_current = <0x1e8480>;
		apple_2_1a_charger_current = <0x1e8480>;
		battery_cv = <0x42ae50>;
		bif_cv_under_threshold2 = <0x43e6d0>;
		bif_threshold1 = <0x40d990>;
		bif_threshold2 = <0x419ce0>;
		cable_imp_threshold = <0x2bb>;
		charging_host_charger_current = <0x7a120>;
		chg1_ta_ac_charger_current = <0x16e360>;
		chg2_ta_ac_charger_current = <0x16e360>;
		compatible = "mediatek,charger";
		dual_polling_ieoc = <0x6ddd0>;
		enable_min_charge_temp;
		enable_sw_jeita;
		enable_sw_safety_timer;
		high_temp_to_enter_pe40 = <0x27>;
		high_temp_to_leave_pe40 = <0x2e>;
		ibus_err = <0x0e>;
		jeita_temp_above_t7_cv = <0x3e4180>;
		jeita_temp_below_t0_cv = <0x3cca80>;
		jeita_temp_t0_to_t1_cc = <0x493e0>;
		jeita_temp_t0_to_t1_cv = <0x3cca80>;
		jeita_temp_t1_to_t2_cc = "\0\aS";
		jeita_temp_t1_to_t2_cv = <0x3cca80>;
		jeita_temp_t2_to_t3_cc = <0xdbba0>;
		jeita_temp_t2_to_t3_cv = <0x42a680>;
		jeita_temp_t3_to_t4_cc = <0x19a280>;
		jeita_temp_t3_to_t4_cv = <0x42a680>;
		jeita_temp_t4_to_t5_cc = <0x1e3660>;
		jeita_temp_t4_to_t5_cv = <0x42a680>;
		jeita_temp_t5_to_t6_cc = <0x107ac0>;
		jeita_temp_t5_to_t6_cv = <0x42a680>;
		jeita_temp_t6_to_t7_cv = <0x3e4180>;
		linux,phandle = <0xa9>;
		low_temp_to_enter_pe40 = <0x10>;
		low_temp_to_leave_pe40 = <0x0a>;
		max_charge_temp = <0x35>;
		max_charge_temp_minus_x_degree = <0x33>;
		max_charger_voltage = <0x588040>;
		min_charge_temp = <0x00>;
		min_charge_temp_plus_x_degree = <0x07>;
		min_charger_voltage = <0x4630c0>;
		non_std_ac_charger_current = <0x1e8480>;
		pd_ichg_level_threshold = <0xf4240>;
		pd_stop_battery_soc = <0x50>;
		pd_vbus_low_bound = <0x4c4b40>;
		pd_vbus_upper_bound = <0x4c4b40>;
		pe20_ichg_level_threshold = <0xf4240>;
		pe40_dual_charger_chg1_current = <0x1e8480>;
		pe40_dual_charger_chg2_current = <0x1e8480>;
		pe40_dual_charger_input_current = <0x2dc6c0>;
		pe40_r_cable_1a_lower = <0x229>;
		pe40_r_cable_2a_lower = <0x19f>;
		pe40_r_cable_3a_lower = <0x113>;
		pe40_single_charger_current = <0x2dc6c0>;
		pe40_single_charger_input_current = <0x2dc6c0>;
		pe40_stop_battery_soc = <0x50>;
		pe_ichg_level_threshold = <0xf4240>;
		phandle = <0xa9>;
		power_path_support;
		slave_mivr_diff = <0x186a0>;
		ta_12v_support;
		ta_9v_support;
		ta_ac_12v_input_current = <0x30d400>;
		ta_ac_7v_input_current = <0x30d400>;
		ta_ac_9v_input_current = <0x30d400>;
		ta_ac_charger_current = <0x2dc6c0>;
		ta_start_battery_soc = <0x00>;
		ta_stop_battery_soc = <0x55>;
		temp_neg_10_thres = <0x00>;
		temp_t0_thres = <0x00>;
		temp_t0_thres_plus_x_degree = <0x02>;
		temp_t1_thres = <0x05>;
		temp_t1_thres_plus_x_degree = <0x07>;
		temp_t2_thres = <0x0c>;
		temp_t2_thres_plus_x_degree = <0x0e>;
		temp_t3_thres = <0x16>;
		temp_t3_thres_minus_x_degree = <0x14>;
		temp_t4_thres = <0x2d>;
		temp_t4_thres_minus_x_degree = <0x2b>;
		temp_t5_thres = <0x35>;
		temp_t5_thres_minus_x_degree = <0x33>;
		usb_charger_current = <0x7a120>;
		usb_charger_current_configured = <0x7a120>;
		usb_charger_current_suspend = <0x00>;
		usb_charger_current_unconfigured = <0x11170>;
		vbat_cable_imp_threshold = <0x3b8260>;
		vsys_watt = <0x4c4b40>;
	};

	chipid@08000000 {
		compatible = "mediatek,chipid";
		reg = <0x00 0x8000000 0x00 0x04 0x00 0x8000004 0x00 0x04 0x00 0x8000008 0x00 0x04 0x00 0x800000c 0x00 0x04>;
	};

	chosen {
		bootargs = "console=tty0 console=ttyS0,921600n1 vmalloc=400M slub_debug=OFZPU page_owner=on swiotlb=noforce androidboot.hardware=mt6765 maxcpus=8 loop.max_part=7 firmware_class.path=/vendor/firmware";
		kaslr-seed = <0x00 0x00>;
		linux,phandle = <0x54>;
		phandle = <0x54>;
	};

	chr_stat {
		linux,phandle = <0xb6>;
		phandle = <0xb6>;
	};

	clocks {

		clk26m {
			#clock-cells = <0x00>;
			clock-frequency = <0x18cba80>;
			compatible = "fixed-clock";
			linux,phandle = <0x1f>;
			phandle = <0x1f>;
		};

		clk32k {
			#clock-cells = <0x00>;
			clock-frequency = <0x7d00>;
			compatible = "fixed-clock";
			linux,phandle = <0x1d>;
			phandle = <0x1d>;
		};
	};

	consys@18002000 {
		#address-cells = <0x02>;
		#size-cells = <0x02>;
		clock-names = "conn";
		clocks = <0x28 0x01>;
		compatible = "mediatek,mt6765-consys";
		interrupts = <0x00 0x10b 0x08 0x00 0x10d 0x08 0x00 0x10e 0x01>;
		linux,phandle = <0x1b>;
		phandle = <0x1b>;
		reg = <0x00 0x18002000 0x00 0x1000 0x00 0x10007000 0x00 0x100 0x00 0x10001000 0x00 0x1000 0x00 0x10006000 0x00 0x1000 0x00 0x18007000 0x00 0x1000 0x00 0x180b1000 0x00 0x1000 0x00 0x180a3000 0x00 0x1000 0x00 0x180a5000 0x00 0x800 0x00 0x180c1000 0x00 0x1000 0x00 0x18004000 0x00 0x1000 0x00 0x00 0x00 0x00 0x00 0x00 0x00 0x00 0x00 0x1020e000 0x00 0x1000>;
	};

	cpu_dbgapb@0d410000 {
		compatible = "mediatek,hw_dbg";
		linux,phandle = <0x56>;
		num = <0x08>;
		phandle = <0x56>;
		reg = <0x00 0xd410000 0x00 0x1000 0x00 0xd510000 0x00 0x1000 0x00 0xd610000 0x00 0x1000 0x00 0xd710000 0x00 0x1000 0x00 0xd810000 0x00 0x1000 0x00 0xd910000 0x00 0x1000 0x00 0xda10000 0x00 0x1000 0x00 0xdb10000 0x00 0x1000>;
	};

	cpus {
		#address-cells = <0x01>;
		#size-cells = <0x00>;

		cpu-map {

			cluster0 {

				core0 {
					cpu = <0x09>;
				};

				core1 {
					cpu = <0x0a>;
				};

				core2 {
					cpu = <0x0b>;
				};

				core3 {
					cpu = <0x0c>;
				};
			};

			cluster1 {

				core0 {
					cpu = <0x0d>;
				};

				core1 {
					cpu = <0x0e>;
				};

				core2 {
					cpu = <0x0f>;
				};

				core3 {
					cpu = <0x10>;
				};
			};
		};

		cpu@000 {
			clock-frequency = <0x89267940>;
			compatible = "arm,cortex-a53";
			cpu-idle-states = <0x02 0x03 0x04 0x05 0x06 0x07 0x08>;
			device_type = "cpu";
			enable-method = "psci";
			linux,phandle = <0x09>;
			phandle = <0x09>;
			reg = <0x00>;
		};

		cpu@001 {
			clock-frequency = <0x89267940>;
			compatible = "arm,cortex-a53";
			cpu-idle-states = <0x02 0x03 0x04 0x05 0x06 0x07 0x08>;
			device_type = "cpu";
			enable-method = "psci";
			linux,phandle = <0x0a>;
			phandle = <0x0a>;
			reg = <0x01>;
		};

		cpu@002 {
			clock-frequency = <0x89267940>;
			compatible = "arm,cortex-a53";
			cpu-idle-states = <0x02 0x03 0x04 0x05 0x06 0x07 0x08>;
			device_type = "cpu";
			enable-method = "psci";
			linux,phandle = <0x0b>;
			phandle = <0x0b>;
			reg = <0x02>;
		};

		cpu@003 {
			clock-frequency = <0x89267940>;
			compatible = "arm,cortex-a53";
			cpu-idle-states = <0x02 0x03 0x04 0x05 0x06 0x07 0x08>;
			device_type = "cpu";
			enable-method = "psci";
			linux,phandle = <0x0c>;
			phandle = <0x0c>;
			reg = <0x03>;
		};

		cpu@100 {
			clock-frequency = <0x6b49d200>;
			compatible = "arm,cortex-a53";
			cpu-idle-states = <0x02 0x03 0x04 0x05 0x06 0x07 0x08>;
			device_type = "cpu";
			enable-method = "psci";
			linux,phandle = <0x0d>;
			phandle = <0x0d>;
			reg = <0x100>;
		};

		cpu@101 {
			clock-frequency = <0x6b49d200>;
			compatible = "arm,cortex-a53";
			cpu-idle-states = <0x02 0x03 0x04 0x05 0x06 0x07 0x08>;
			device_type = "cpu";
			enable-method = "psci";
			linux,phandle = <0x0e>;
			phandle = <0x0e>;
			reg = <0x101>;
		};

		cpu@102 {
			clock-frequency = <0x6b49d200>;
			compatible = "arm,cortex-a53";
			cpu-idle-states = <0x02 0x03 0x04 0x05 0x06 0x07 0x08>;
			device_type = "cpu";
			enable-method = "psci";
			linux,phandle = <0x0f>;
			phandle = <0x0f>;
			reg = <0x102>;
		};

		cpu@103 {
			clock-frequency = <0x6b49d200>;
			compatible = "arm,cortex-a53";
			cpu-idle-states = <0x02 0x03 0x04 0x05 0x06 0x07 0x08>;
			device_type = "cpu";
			enable-method = "psci";
			linux,phandle = <0x10>;
			phandle = <0x10>;
			reg = <0x103>;
		};

		idle-states {
			entry-method = "arm,psci";

			dpidle {
				arm,psci-suspend-param = <0x1010004>;
				compatible = "arm,idle-state";
				entry-latency-us = <0x320>;
				exit-latency-us = <0x3e8>;
				linux,phandle = <0x07>;
				min-residency-us = <0x7d0>;
				phandle = <0x07>;
			};

			mcdi-cluster {
				arm,psci-suspend-param = <0x1010001>;
				compatible = "arm,idle-state";
				entry-latency-us = <0x258>;
				exit-latency-us = <0x258>;
				linux,phandle = <0x04>;
				min-residency-us = <0x4b0>;
				phandle = <0x04>;
			};

			mcdi-cpu {
				arm,psci-suspend-param = <0x10001>;
				compatible = "arm,idle-state";
				entry-latency-us = <0x258>;
				exit-latency-us = <0x258>;
				linux,phandle = <0x03>;
				min-residency-us = <0x4b0>;
				phandle = <0x03>;
			};

			sodi {
				arm,psci-suspend-param = <0x1010002>;
				compatible = "arm,idle-state";
				entry-latency-us = <0x320>;
				exit-latency-us = <0x3e8>;
				linux,phandle = <0x05>;
				min-residency-us = <0x7d0>;
				phandle = <0x05>;
			};

			sodi3 {
				arm,psci-suspend-param = <0x1010003>;
				compatible = "arm,idle-state";
				entry-latency-us = <0x320>;
				exit-latency-us = <0x3e8>;
				linux,phandle = <0x06>;
				min-residency-us = <0x7d0>;
				phandle = <0x06>;
			};

			standby {
				arm,psci-suspend-param = <0x01>;
				compatible = "arm,idle-state";
				entry-latency-us = <0x258>;
				exit-latency-us = <0x258>;
				linux,phandle = <0x02>;
				min-residency-us = <0x4b0>;
				phandle = <0x02>;
			};

			suspend {
				arm,psci-suspend-param = <0x1010005>;
				compatible = "arm,idle-state";
				entry-latency-us = <0x320>;
				exit-latency-us = <0x3e8>;
				linux,phandle = <0x08>;
				min-residency-us = <0x7d0>;
				phandle = <0x08>;
			};
		};
	};

	cq_dma@10212000 {
		clock-names = "cqdma";
		clocks = <0x27 0x43>;
		compatible = "mediatek,mt-cqdma-v1";
		interrupts = <0x00 0x71 0x08 0x00 0x72 0x08>;
		keep_clock_ao = "yes";
		nr_channel = <0x02>;
		reg = <0x00 0x10212000 0x00 0x80 0x00 0x10212080 0x00 0x80>;
	};

	dbg_apmcu_mp0@0d400000 {
		compatible = "mediatek,dbg_apmcu_mp0";
		reg = <0x00 0xd400000 0x00 0x1000>;
	};

	dbg_apmcu_mp0@0d410000 {
		compatible = "mediatek,dbg_apmcu_mp0";
		reg = <0x00 0xd410000 0x00 0x1000>;
	};

	dbg_apmcu_mp0@0d420000 {
		compatible = "mediatek,dbg_apmcu_mp0";
		reg = <0x00 0xd420000 0x00 0x1000>;
	};

	dbg_apmcu_mp0@0d430000 {
		compatible = "mediatek,dbg_apmcu_mp0";
		reg = <0x00 0xd430000 0x00 0x1000>;
	};

	dbg_apmcu_mp0@0d440000 {
		compatible = "mediatek,dbg_apmcu_mp0";
		reg = <0x00 0xd440000 0x00 0x1000>;
	};

	dbg_apmcu_mp0@0d510000 {
		compatible = "mediatek,dbg_apmcu_mp0";
		reg = <0x00 0xd510000 0x00 0x1000>;
	};

	dbg_apmcu_mp0@0d520000 {
		compatible = "mediatek,dbg_apmcu_mp0";
		reg = <0x00 0xd520000 0x00 0x1000>;
	};

	dbg_apmcu_mp0@0d530000 {
		compatible = "mediatek,dbg_apmcu_mp0";
		reg = <0x00 0xd530000 0x00 0x1000>;
	};

	dbg_apmcu_mp0@0d540000 {
		compatible = "mediatek,dbg_apmcu_mp0";
		reg = <0x00 0xd540000 0x00 0x1000>;
	};

	dbg_apmcu_mp0@0d610000 {
		compatible = "mediatek,dbg_apmcu_mp0";
		reg = <0x00 0xd610000 0x00 0x1000>;
	};

	dbg_apmcu_mp0@0d620000 {
		compatible = "mediatek,dbg_apmcu_mp0";
		reg = <0x00 0xd620000 0x00 0x1000>;
	};

	dbg_apmcu_mp0@0d630000 {
		compatible = "mediatek,dbg_apmcu_mp0";
		reg = <0x00 0xd630000 0x00 0x1000>;
	};

	dbg_apmcu_mp0@0d640000 {
		compatible = "mediatek,dbg_apmcu_mp0";
		reg = <0x00 0xd640000 0x00 0x1000>;
	};

	dbg_apmcu_mp0@0d710000 {
		compatible = "mediatek,dbg_apmcu_mp0";
		reg = <0x00 0xd710000 0x00 0x1000>;
	};

	dbg_apmcu_mp0@0d720000 {
		compatible = "mediatek,dbg_apmcu_mp0";
		reg = <0x00 0xd720000 0x00 0x1000>;
	};

	dbg_apmcu_mp0@0d730000 {
		compatible = "mediatek,dbg_apmcu_mp0";
		reg = <0x00 0xd730000 0x00 0x1000>;
	};

	dbg_apmcu_mp0@0d740000 {
		compatible = "mediatek,dbg_apmcu_mp0";
		reg = <0x00 0xd740000 0x00 0x1000>;
	};

	dbg_apmcu_mp1@0d800000 {
		compatible = "mediatek,dbg_apmcu_mp1";
		reg = <0x00 0xd800000 0x00 0x1000>;
	};

	dbg_apmcu_mp1@0d810000 {
		compatible = "mediatek,dbg_apmcu_mp1";
		reg = <0x00 0xd810000 0x00 0x1000>;
	};

	dbg_apmcu_mp1@0d820000 {
		compatible = "mediatek,dbg_apmcu_mp1";
		reg = <0x00 0xd820000 0x00 0x1000>;
	};

	dbg_apmcu_mp1@0d830000 {
		compatible = "mediatek,dbg_apmcu_mp1";
		reg = <0x00 0xd830000 0x00 0x1000>;
	};

	dbg_apmcu_mp1@0d840000 {
		compatible = "mediatek,dbg_apmcu_mp1";
		reg = <0x00 0xd840000 0x00 0x1000>;
	};

	dbg_apmcu_mp1@0d910000 {
		compatible = "mediatek,dbg_apmcu_mp1";
		reg = <0x00 0xd910000 0x00 0x1000>;
	};

	dbg_apmcu_mp1@0d920000 {
		compatible = "mediatek,dbg_apmcu_mp1";
		reg = <0x00 0xd920000 0x00 0x1000>;
	};

	dbg_apmcu_mp1@0d930000 {
		compatible = "mediatek,dbg_apmcu_mp1";
		reg = <0x00 0xd930000 0x00 0x1000>;
	};

	dbg_apmcu_mp1@0d940000 {
		compatible = "mediatek,dbg_apmcu_mp1";
		reg = <0x00 0xd940000 0x00 0x1000>;
	};

	dbg_apmcu_mp1@0da10000 {
		compatible = "mediatek,dbg_apmcu_mp1";
		reg = <0x00 0xda10000 0x00 0x1000>;
	};

	dbg_apmcu_mp1@0da20000 {
		compatible = "mediatek,dbg_apmcu_mp1";
		reg = <0x00 0xda20000 0x00 0x1000>;
	};

	dbg_apmcu_mp1@0da30000 {
		compatible = "mediatek,dbg_apmcu_mp1";
		reg = <0x00 0xda30000 0x00 0x1000>;
	};

	dbg_apmcu_mp1@0da40000 {
		compatible = "mediatek,dbg_apmcu_mp1";
		reg = <0x00 0xda40000 0x00 0x1000>;
	};

	dbg_apmcu_mp1@0db10000 {
		compatible = "mediatek,dbg_apmcu_mp1";
		reg = <0x00 0xdb10000 0x00 0x1000>;
	};

	dbg_apmcu_mp1@0db20000 {
		compatible = "mediatek,dbg_apmcu_mp1";
		reg = <0x00 0xdb20000 0x00 0x1000>;
	};

	dbg_apmcu_mp1@0db30000 {
		compatible = "mediatek,dbg_apmcu_mp1";
		reg = <0x00 0xdb30000 0x00 0x1000>;
	};

	dbg_apmcu_mp1@0db40000 {
		compatible = "mediatek,dbg_apmcu_mp1";
		reg = <0x00 0xdb40000 0x00 0x1000>;
	};

	dbg_cti@0d020000 {
		compatible = "mediatek,dbg_cti";
		reg = <0x00 0xd020000 0x00 0x10000>;
	};

	dbg_dem@0d0a0000 {
		compatible = "mediatek,dbg_dem";
		interrupts = <0x00 0x8c 0x08>;
		reg = <0x00 0xd0a0000 0x00 0x10000>;
	};

	dbg_etr@0d030000 {
		compatible = "mediatek,dbg_etr";
		reg = <0x00 0xd030000 0x00 0x10000>;
	};

	dbg_funnel@0d040000 {
		compatible = "mediatek,dbg_funnel";
		reg = <0x00 0xd040000 0x00 0x10000>;
	};

	dbg_mdsys1@0d0c0000 {
		compatible = "mediatek,dbg_mdsys1";
		reg = <0x00 0xd0c0000 0x00 0x40000>;
	};

	ddrphy@10015000 {
		compatible = "mediatek,ddrphy";
		reg = <0x00 0x10015000 0x00 0x1000>;
	};

	ddrphy@1001e000 {
		compatible = "mediatek,ddrphy";
		reg = <0x00 0x1001e000 0x00 0x1000>;
	};

	devapc@10207000 {
		clock-names = "devapc-infra-clock";
		clocks = <0x27 0x28>;
		compatible = "mediatek,devapc";
		interrupts = <0x00 0x8e 0x08>;
		reg = <0x00 0x10207000 0x00 0x1000 0x00 0x1000e000 0x00 0x1000>;
	};

	dfd@10200b00 {
		compatible = "mediatek,dfd";
		mediatek,chain_length = <0xc350>;
		mediatek,enabled = <0x01>;
		mediatek,rg_dfd_timeout = <0xa0>;
		reg = <0x00 0x10200b00 0x00 0x10000>;
	};

	dip1@15022000 {
		compatible = "mediatek,dip1";
		interrupts = <0x00 0xff 0x08>;
		reg = <0x00 0x15022000 0x00 0x3000>;
	};

	disp_aal0@14011000 {
		compatible = "mediatek,disp_aal0";
		interrupts = <0x00 0xde 0x08>;
		reg = <0x00 0x14011000 0x00 0x1000>;
	};

	disp_ccorr0@14010000 {
		compatible = "mediatek,disp_ccorr0";
		interrupts = <0x00 0xdd 0x08>;
		reg = <0x00 0x14010000 0x00 0x1000>;
	};

	disp_color0@1400f000 {
		clock-names = "MDP_COLOR";
		clocks = <0x29 0x0c>;
		compatible = "mediatek,disp_color0";
		interrupts = <0x00 0xdc 0x08>;
		linux,phandle = <0x30>;
		phandle = <0x30>;
		reg = <0x00 0x1400f000 0x00 0x1000>;
	};

	disp_dither0@14013000 {
		compatible = "mediatek,disp_dither0";
		interrupts = <0x00 0xe0 0x08>;
		reg = <0x00 0x14013000 0x00 0x1000>;
	};

	disp_gamma0@14012000 {
		compatible = "mediatek,disp_gamma0";
		interrupts = <0x00 0xdf 0x08>;
		reg = <0x00 0x14012000 0x00 0x1000>;
	};

	disp_mutex0@14001000 {
		compatible = "mediatek,disp_mutex0";
		interrupts = <0x00 0xd2 0x08>;
		linux,phandle = <0x32>;
		phandle = <0x32>;
		reg = <0x00 0x14001000 0x00 0x1000>;
	};

	disp_ovl0@1400b000 {
		compatible = "mediatek,disp_ovl0";
		interrupts = <0x00 0xd9 0x08>;
		reg = <0x00 0x1400b000 0x00 0x1000>;
	};

	disp_ovl0_2l@1400c000 {
		compatible = "mediatek,disp_ovl0_2l";
		interrupts = <0x00 0xe5 0x08>;
		reg = <0x00 0x1400c000 0x00 0x1000>;
	};

	disp_pwm@1100e000 {
		compatible = "mediatek,disp_pwm";
		reg = <0x00 0x1100e000 0x00 0x1000>;
	};

	disp_rdma0@1400d000 {
		compatible = "mediatek,disp_rdma0";
		interrupts = <0x00 0xda 0x08>;
		reg = <0x00 0x1400d000 0x00 0x1000>;
	};

	disp_rsz0@14015000 {
		compatible = "mediatek,disp_rsz0";
		interrupts = <0x00 0x114 0x08>;
		reg = <0x00 0x14015000 0x00 0x1000>;
	};

	disp_wdma0@1400e000 {
		compatible = "mediatek,disp_wdma0";
		interrupts = <0x00 0xdb 0x08>;
		reg = <0x00 0x1400e000 0x00 0x1000>;
	};

	dispsys {
		clock-names = "MMSYS_MTCMOS\0MMSYS_SMI_COMMON\0MMSYS_SMI_LARB0\0MMSYS_GALS_COMM0\0MMSYS_GALS_COMM1\0MMSYS_DISP_OVL0\0MMSYS_DISP_OVL0_2L\0MMSYS_DISP_RDMA0\0MMSYS_DISP_WDMA0\0MMSYS_DISP_COLOR0\0MMSYS_DISP_CCORR0\0MMSYS_DISP_AAL0\0MMSYS_DISP_GAMMA0\0MMSYS_DISP_DITHER0\0MMSYS_DSI0_MM_CK\0MMSYS_DSI0_IF_CK\0MMSYS_26M\0MMSYS_DISP_RSZ0\0APMIXED_MIPI_26M\0TOP_MUX_DISP_PWM\0DISP_PWM\0TOP_26M\0TOP_UNIVPLL2_D4\0TOP_ULPOSC1_D2\0TOP_ULPOSC1_D8";
		clocks = <0x28 0x03 0x29 0x13 0x29 0x14 0x29 0x15 0x29 0x16 0x29 0x07 0x29 0x08 0x29 0x0a 0x29 0x0b 0x29 0x0c 0x29 0x0d 0x29 0x0e 0x29 0x0f 0x29 0x10 0x29 0x11 0x29 0x1c 0x29 0x1d 0x29 0x09 0x43 0x15 0x1e 0x73 0x27 0x31 0x1f 0x1e 0x1b 0x1e 0x2e 0x1e 0x30>;
		compatible = "mediatek,dispsys";
		mediatek,larb = <0x23>;
	};

	dma-controller@11000580 {
		#dma-cells = <0x01>;
		clock-names = "apdma";
		clocks = <0x27 0x26>;
		compatible = "mediatek,mt6577-uart-dma";
		interrupts = <0x00 0x6d 0x08 0x00 0x6e 0x08 0x00 0x6f 0x08 0x00 0x74 0x08>;
		linux,phandle = <0x34>;
		phandle = <0x34>;
		reg = <0x00 0x11000680 0x00 0x80 0x00 0x11000700 0x00 0x80 0x00 0x11000780 0x00 0x80 0x00 0x11000800 0x00 0x80>;
	};

	dpe@15028000 {
		clock-names = "DPE_CG_IMG_DPE";
		clocks = <0x44 0x03>;
		compatible = "mediatek,dpe";
		interrupts = <0x00 0x100 0x08>;
		reg = <0x00 0x15028000 0x00 0x1000>;
	};

	dramc0@1001d000 {
		compatible = "mediatek,dramc0";
		reg = <0x00 0x1001d000 0x00 0x1000>;
	};

	dramc@1022a000 {
		compatible = "mediatek,dramc";
		reg = <0x00 0x1022a000 0x00 0x2000 0x00 0x10232000 0x00 0x2000 0x00 0x1022c000 0x00 0x1000 0x00 0x10234000 0x00 0x1000 0x00 0x10228000 0x00 0x2000 0x00 0x10230000 0x00 0x2000 0x00 0x1022e000 0x00 0x1000 0x00 0x10236000 0x00 0x1000>;
	};

	dramc_nao@1021d000 {
		compatible = "mediatek,dramc_nao";
		reg = <0x00 0x1021d000 0x00 0x1000>;
	};

	dsi0@14014000 {
		compatible = "mediatek,dsi0";
		interrupts = <0x00 0xe1 0x08>;
		reg = <0x00 0x14014000 0x00 0x1000>;
	};

	dsi_te {
		compatible = "mediatek, DSI_TE-eint";
		linux,phandle = <0xa2>;
		phandle = <0xa2>;
		status = "disabled";
	};

	dvfsp@00110800 {
		compatible = "mediatek,mt6765-dvfsp";
		reg = <0x00 0x110800 0x00 0x1400 0x00 0x110800 0x00 0x1400>;
	};

	dvfsp@10227000 {
		compatible = "mediatek,dvfsp";
		reg = <0x00 0x10227000 0x00 0x1000>;
	};

	dvfsrc@10012000 {
		compatible = "mediatek,dvfsrc";
		reg = <0x00 0x10012000 0x00 0x1000 0x00 0x110780 0x00 0x80>;
	};

	dxcc_sec@10210000 {
		compatible = "mediatek,dxcc_sec";
		interrupts = <0x00 0xa2 0x04>;
		reg = <0x00 0x10210000 0x00 0x1000>;
	};

	dynamic_options {
		compatible = "mediatek,dynamic_options";
		linux,phandle = <0xbb>;
		phandle = <0xbb>;
	};

	eas {
		eff_turn_point = <0x1d3>;
		tiny = <0x32>;
	};

	eem_fsm@1100b000 {
		compatible = "mediatek,eem_fsm";
		interrupts = <0x00 0x7d 0x08>;
		reg = <0x00 0x1100b000 0x00 0x1000>;
	};

	efuse_dbg@10004000 {
		compatible = "mediatek,efuse_dbg";
		reg = <0x00 0x10004000 0x00 0x1000>;
	};

	efusec@11c50000 {
		compatible = "mediatek,efusec";
		reg = <0x00 0x11c50000 0x00 0x10000>;
	};

	emi@10219000 {
		compatible = "mediatek,emi";
		interrupts = <0x00 0x90 0x08>;
		reg = <0x00 0x10219000 0x00 0x1000 0x00 0x10226000 0x00 0x1000 0x00 0x1022d000 0x00 0x1000 0x00 0x10235000 0x00 0x1000>;
	};

	fdvt@1502b000 {
		clock-names = "FD_CLK_IMG_FDVT";
		clocks = <0x44 0x02>;
		compatible = "mediatek,fdvt";
		interrupts = <0x00 0x102 0x08>;
		reg = <0x00 0x1502b000 0x00 0x1000>;
	};

	fhctl@1000ce00 {
		compatible = "mediatek,fhctl";
		reg = <0x00 0x1000ce00 0x00 0x200>;
	};

	fingerprint {
		compatible = "mediatek,goodix-fp";
		linux,phandle = <0x81>;
		phandle = <0x81>;
	};

	firmware {

		android {
			compatible = "android,firmware";

			fstab {
				compatible = "android,fstab";

				system {
					compatible = "android,system";
					dev = "/dev/block/platform/bootdevice/by-name/system";
					fsmgr_flags = "wait,avb";
					mnt_flags = "ro,async_discard";
					type = "ext4";
				};

				vendor {
					compatible = "android,vendor";
					dev = "/dev/block/platform/bootdevice/by-name/vendor";
					fsmgr_flags = "wait,avb";
					mnt_flags = "ro,async_discard";
					type = "ext4";
				};
			};

			vbmeta {
				compatible = "android,vbmeta";
				parts = "vbmeta,boot,system,vendor,recovery";
			};
		};
	};

	flashlight_core {
		compatible = "mediatek,flashlight_core";
		linux,phandle = <0xa4>;
		phandle = <0xa4>;
	};

	flashlights_gpio {
		compatible = "mediatek,flashlights_dummy_gpio";
		linux,phandle = <0xa6>;
		phandle = <0xa6>;
		pinctrl-0 = <0x4d>;
		pinctrl-1 = <0x4e>;
		pinctrl-2 = <0x4f>;
		pinctrl-3 = <0x50>;
		pinctrl-4 = <0x51>;
		pinctrl-5 = <0x52>;
		pinctrl-names = "default\0strobe_on_gpio\0strobe_off_gpio\0torch_on_gpio\0torch_off_gpio\0torch_pwm_gpio";
		status = "okay";

		channel@1 {
			ct = <0x00>;
			part = <0x00>;
			type = <0x00>;
		};
	};

	flashlights_mt6370 {
		compatible = "mediatek,flashlights_mt6370";
		decouple = <0x00>;
		linux,phandle = <0xa5>;
		phandle = <0xa5>;

		channel@1 {
			ct = <0x00>;
			part = <0x00>;
			type = <0x00>;
		};

		channel@2 {
			ct = <0x01>;
			part = <0x00>;
			type = <0x00>;
		};
	};

	gauge_timer {
		compatible = "mediatek,gauge_timer_service";
	};

	gce@10238000 {
		#clock-cells = <0x01>;
		ap_dma_base = <0x18010000 0x17 0xffff0000>;
		audio_base = <0x17000000 0x12 0xffff0000>;
		buf_underrun_event_0 = <0x8c>;
		camsys1_base = <0x180a0000 0x1c 0xffff0000>;
		camsys2_base = <0x180b0000 0x1d 0xffff0000>;
		camsys_base = <0x18080000 0x1b 0xffff0000>;
		clock-names = "GCE\0GCE_TIMER";
		clocks = <0x27 0x09 0x27 0x18>;
		compatible = "mediatek,gce\0syscon";
		conn_peri_base = <0x18820000 0x07 0xffff0000>;
		dip_cq_thread0_frame_done = <0x101>;
		dip_cq_thread10_frame_done = <0x10b>;
		dip_cq_thread11_frame_done = <0x10c>;
		dip_cq_thread12_frame_done = <0x10d>;
		dip_cq_thread13_frame_done = <0x10e>;
		dip_cq_thread14_frame_done = <0x10f>;
		dip_cq_thread15_frame_done = <0x110>;
		dip_cq_thread16_frame_done = <0x111>;
		dip_cq_thread17_frame_done = <0x112>;
		dip_cq_thread18_frame_done = <0x113>;
		dip_cq_thread1_frame_done = <0x102>;
		dip_cq_thread2_frame_done = <0x103>;
		dip_cq_thread3_frame_done = <0x104>;
		dip_cq_thread4_frame_done = <0x105>;
		dip_cq_thread5_frame_done = <0x106>;
		dip_cq_thread6_frame_done = <0x107>;
		dip_cq_thread7_frame_done = <0x108>;
		dip_cq_thread8_frame_done = <0x109>;
		dip_cq_thread9_frame_done = <0x10a>;
		disp_2l_ovl0_frame_done = <0x1c>;
		disp_2l_ovl0_sof = <0x08>;
		disp_aal0_frame_done = <0x22>;
		disp_aal0_sof = <0x0d>;
		disp_ccorr0_frame_done = <0x21>;
		disp_ccorr0_sof = <0x0c>;
		disp_color0_frame_done = <0x20>;
		disp_color0_sof = <0x0b>;
		disp_dither0_frame_done = <0x24>;
		disp_dither0_sof = <0x0f>;
		disp_dither_base = <0x14010000 0x02 0xffff0000>;
		disp_dsi0_frame_done = <0x25>;
		disp_dsi0_sof = <0x10>;
		disp_gamma0_frame_done = <0x23>;
		disp_gamma0_sof = <0x0e>;
		disp_ovl0_frame_done = <0x1b>;
		disp_ovl0_frame_rst_done_pusle = <0x98>;
		disp_ovl0_sof = <0x07>;
		disp_pwm0_sof = <0x13>;
		disp_rdma0_frame_done = <0x1e>;
		disp_rdma0_sof = <0x09>;
		disp_rsz0_frame_done = <0x1d>;
		disp_rsz0_sof = <0x11>;
		disp_wdma0_frame_done = <0x1f>;
		disp_wdma0_rst_done = <0x93>;
		disp_wdma0_sof = <0x0a>;
		dsi0_done_event = <0x8f>;
		dsi0_irq_event = <0x8e>;
		dsi0_te_event = <0x8d>;
		dve_frame_done = <0x114>;
		g3d_config_base = <0x13000000 0x00 0xffff0000>;
		gce_base = <0x18020000 0x18 0xffff0000>;
		gcpu_base = <0x10050000 0x0f 0xffff0000>;
		img_dl_relay_sof = <0x12>;
		imgsys_base = <0x15020000 0x04 0xffff0000>;
		infra_na3_base = <0x10010000 0x0b 0xffff0000>;
		infra_na4_base = <0x10020000 0x0c 0xffff0000>;
		interrupts = <0x00 0x9a 0x08 0x00 0x9b 0x08>;
		jpgdec_done = <0x123>;
		jpgenc_done = <0x122>;
		kp_base = <0x18840000 0x09 0xffff0000>;
		linux,phandle = <0x84>;
		max_prefetch_cnt = <0x01>;
		mboxes = <0x33 0x00 0x00 0x04 0x33 0x01 0x00 0x04 0x33 0x02 0x00 0x05 0x33 0x03 0x00 0x04 0x33 0x04 0x00 0x04 0x33 0x05 0x00 0x04 0x33 0x06 0x00 0x03 0x33 0x07 0xffffffff 0x02 0x33 0x08 0x00 0x01 0x33 0x09 0x00 0x01 0x33 0x0a 0x00 0x01 0x33 0x0b 0x00 0x01 0x33 0x0c 0x00 0x01 0x33 0x0d 0x00 0x01 0x33 0x0e 0x00 0x01 0x33 0x0f 0x00 0x01>;
		mcucfg_base = <0x10040000 0x0e 0xffff0000>;
		mdp_ccorr0 = <0x31>;
		mdp_ccorr0_frame_done = <0x15>;
		mdp_ccorr0_sof = <0x01>;
		mdp_color0 = <0x30>;
		mdp_rdma0 = <0x2a>;
		mdp_rdma0_frame_done = <0x14>;
		mdp_rdma0_rst_done = <0x97>;
		mdp_rdma0_sof = <0x00>;
		mdp_rsz0 = <0x2b>;
		mdp_rsz0_frame_done = <0x16>;
		mdp_rsz0_sof = <0x02>;
		mdp_rsz1 = <0x2c>;
		mdp_rsz1_frame_done = <0x17>;
		mdp_rsz1_sof = <0x03>;
		mdp_tdshp0 = <0x2f>;
		mdp_tdshp0_frame_done = <0x1a>;
		mdp_tdshp0_sof = <0x06>;
		mdp_wdma0 = <0x2d>;
		mdp_wdma_frame_done = <0x19>;
		mdp_wdma_rst_done = <0x94>;
		mdp_wdma_sof = <0x04>;
		mdp_wrot0 = <0x2e>;
		mdp_wrot0_rst_done = <0x95>;
		mdp_wrot0_sof = <0x05>;
		mdp_wrot0_write_frame_done = <0x18>;
		mediatek,mailbox-gce = <0x33>;
		mipitx0_base = <0x11c80000 0x63 0xffff0000>;
		mm_mutex = <0x32>;
		mm_na_base = <0x14020000 0x03 0xffff0000>;
		mmsys_config = <0x29>;
		mmsys_config_base = <0x14000000 0x01 0xffff0000>;
		msdc2_base = <0x17020000 0x14 0xffff0000>;
		msdc3_base = <0x18000000 0x16 0xffff0000>;
		phandle = <0x84>;
		prefetch_size = <0x60>;
		pwm_sw_base = <0x1100e000 0x63 0xffff0000>;
		reg = <0x00 0x10238000 0x00 0x4000>;
		rsc_frame_done = <0x116>;
		scp_base = <0x10030000 0x0d 0xffff0000>;
		scp_sram_base = <0x10000000 0x0a 0xffff0000>;
		secure_thread = <0x08 0x0a>;
		sram_share_cnt = <0x01>;
		sram_share_engine = <0x0a>;
		sram_share_event = <0x2c6>;
		sram_size_cpr_64 = <0x40>;
		stream_done_0 = <0x82>;
		stream_done_1 = <0x83>;
		stream_done_2 = <0x84>;
		stream_done_3 = <0x85>;
		stream_done_4 = <0x86>;
		stream_done_5 = <0x87>;
		stream_done_6 = <0x88>;
		stream_done_7 = <0x89>;
		stream_done_8 = <0x8a>;
		stream_done_9 = <0x8b>;
		thread_count = <0x10>;
		topckgen_base = <0x18830000 0x08 0xffff0000>;
		usb0_base = <0x10200000 0x10 0xffff0000>;
		usb_sif_base = <0x10280000 0x11 0xffff0000>;
		vdec1_base = <0x17030000 0x15 0xffff0000>;
		vdec2_base = <0x18040000 0x19 0xffff0000>;
		vdec3_base = <0x18050000 0x1a 0xffff0000>;
		vdec_base = <0x17010000 0x13 0xffff0000>;
		vdec_gcon_base = <0x18800000 0x05 0xffff0000>;
		venc_128byte_cnt_done = <0x125>;
		venc_done = <0x121>;
		venc_gcon_base = <0x18810000 0x06 0xffff0000>;
		venc_mb_done = <0x124>;
		wmf_frame_done = <0x115>;
	};

	gce_mbox@10238000 {
		#gce-event-cells = <0x01>;
		#gce-subsys-cells = <0x02>;
		#mbox-cells = <0x03>;
		clock-names = "gce\0GCE_TIMER";
		clocks = <0x27 0x09 0x27 0x18>;
		compatible = "mediatek,mailbox-gce";
		interrupts = <0x00 0x9a 0x08 0x00 0x9b 0x08>;
		linux,phandle = <0x33>;
		phandle = <0x33>;
		reg = <0x00 0x10238000 0x00 0x4000>;
	};

	gce_mbox_svp@10238000 {
		#mbox-cells = <0x03>;
		clock-names = "gce\0GCE_TIMER";
		clocks = <0x27 0x09 0x27 0x18>;
		compatible = "mediatek,mailbox-gce-svp";
		interrupts = <0x00 0x9a 0x08 0x00 0x9b 0x08>;
		linux,phandle = <0x85>;
		phandle = <0x85>;
		reg = <0x00 0x10238000 0x00 0x4000>;
	};

	gic500@0c000000 {
		compatible = "mediatek,gic500";
		reg = <0x00 0xc000000 0x00 0x1000>;
	};

	gic_cpu@0c400000 {
		compatible = "mediatek,gic_cpu";
		reg = <0x00 0xc400000 0x00 0x40000>;
	};

	gpio {
		compatible = "mediatek,gpio_usage_mapping";
		linux,phandle = <0x58>;
		phandle = <0x58>;
	};

	gpio@10005000 {
		compatible = "mediatek,gpio";
		linux,phandle = <0x59>;
		phandle = <0x59>;
		reg = <0x00 0x10005000 0x00 0x1000>;
	};

	gps {
		compatible = "mediatek,gps";
	};

	gpufreq {
		clock-names = "clk_mux\0clk_main_parent\0clk_sub_parent\0mtcmos_mfg_async\0mtcmos_mfg\0mtcmos_mfg_core0";
		clocks = <0x1e 0x64 0x1e 0x26 0x1f 0x28 0x08 0x28 0x04 0x28 0x07>;
		compatible = "mediatek,mt6765-gpufreq";
	};

	gse_1 {
		linux,phandle = <0xb7>;
		phandle = <0xb7>;
	};

	hacc@1000a000 {
		compatible = "mediatek,hacc";
		interrupts = <0x00 0xbd 0x08>;
		reg = <0x00 0x1000a000 0x00 0x1000>;
	};

	i2c0@11007000 {
		aed = <0x1a>;
		clock-div = <0x05>;
		clock-names = "main\0dma";
		clocks = <0x27 0x0b 0x27 0x26>;
		compatible = "mediatek,i2c";
		eh_cfg = <0x20>;
		gpio_start = <0x10002a00>;
		id = <0x00>;
		interrupts = <0x00 0x54 0x08>;
		linux,phandle = <0x8a>;
		mediatek,hs_only;
		mem_len = <0x200>;
		phandle = <0x8a>;
		pu_cfg = <0x50>;
		reg = <0x00 0x11007000 0x00 0x1000 0x00 0x11000080 0x00 0x80>;
		rsel_cfg = <0x70>;
		scl-gpio-id = <0x53>;
		sda-gpio-id = <0x52>;
	};

	i2c1@11008000 {
		aed = <0x1a>;
		clock-div = <0x05>;
		clock-names = "main\0dma";
		clocks = <0x27 0x0b 0x27 0x26>;
		compatible = "mediatek,i2c";
		eh_cfg = <0x20>;
		gpio_start = <0x10002a00>;
		id = <0x01>;
		interrupts = <0x00 0x55 0x08>;
		linux,phandle = <0x8b>;
		mediatek,hs_only;
		mem_len = <0x200>;
		phandle = <0x8b>;
		pu_cfg = <0x50>;
		reg = <0x00 0x11008000 0x00 0x1000 0x00 0x11000100 0x00 0x80>;
		rsel_cfg = <0x70>;
		scl-gpio-id = <0x54>;
		sda-gpio-id = <0x51>;
	};

	i2c2@11009000 {
		aed = <0x1a>;
		ch_offset_ccu = <0x200>;
		ch_offset_default = <0x100>;
		clock-div = <0x05>;
		clock-names = "main\0dma";
		clocks = <0x27 0x0b 0x27 0x26>;
		compatible = "mediatek,i2c";
		eh_cfg = <0x20>;
		gpio_start = <0x10002800>;
		id = <0x02>;
		interrupts = <0x00 0x56 0x08>;
		linux,phandle = <0x8c>;
		mediatek,hs_only;
		mem_len = <0x200>;
		phandle = <0x8c>;
		pu_cfg = <0x60>;
		reg = <0x00 0x11009000 0x00 0x1000 0x00 0x11000180 0x00 0x180>;
		rsel_cfg = <0xa0>;
		scl-gpio-id = <0x67>;
		sda-gpio-id = <0x68>;
	};

	i2c3@1100f000 {
		aed = <0x1a>;
		ch_offset_default = <0x100>;
		clock-div = <0x05>;
		clock-names = "main\0dma";
		clocks = <0x27 0x0b 0x27 0x26>;
		compatible = "mediatek,i2c";
		eh_cfg = <0x20>;
		gpio_start = <0x10002600>;
		id = <0x03>;
		interrupts = <0x00 0x57 0x08>;
		linux,phandle = <0x8d>;
		mediatek,hs_only;
		mem_len = <0x200>;
		phandle = <0x8d>;
		pu_cfg = <0x90>;
		reg = <0x00 0x1100f000 0x00 0x1000 0x00 0x11000300 0x00 0x100>;
		rsel_cfg = <0xb0>;
		scl-gpio-id = <0x32>;
		sda-gpio-id = <0x33>;
	};

	i2c4@11011000 {
		aed = <0x1a>;
		ch_offset_ccu = <0x200>;
		ch_offset_default = <0x100>;
		clock-div = <0x05>;
		clock-names = "main\0dma";
		clocks = <0x27 0x0b 0x27 0x26>;
		compatible = "mediatek,i2c";
		eh_cfg = <0x20>;
		gpio_start = <0x10002800>;
		id = <0x04>;
		interrupts = <0x00 0x58 0x08>;
		linux,phandle = <0x8e>;
		mediatek,hs_only;
		mem_len = <0x200>;
		phandle = <0x8e>;
		pu_cfg = <0x60>;
		reg = <0x00 0x11011000 0x00 0x1000 0x00 0x11000400 0x00 0x180>;
		rsel_cfg = <0xa0>;
		scl-gpio-id = <0x69>;
		sda-gpio-id = <0x6a>;
	};

	i2c5@11016000 {
		aed = <0x1a>;
		clock-div = <0x05>;
		clock-names = "main\0dma";
		clocks = <0x27 0x0b 0x27 0x26>;
		compatible = "mediatek,i2c";
		eh_cfg = <0x20>;
		gpio_start = <0x10002600>;
		id = <0x05>;
		interrupts = <0x00 0x82 0x08>;
		linux,phandle = <0x8f>;
		mediatek,hs_only;
		mem_len = <0x200>;
		phandle = <0x8f>;
		pu_cfg = <0x90>;
		reg = <0x00 0x11016000 0x00 0x1000 0x00 0x11000580 0x00 0x80>;
		rsel_cfg = <0xb0>;
		scl-gpio-id = <0x30>;
		sda-gpio-id = <0x31>;
	};

	i2c6@1100d000 {
		aed = <0x1a>;
		ch_offset_ccu = <0x200>;
		ch_offset_default = <0x100>;
		clock-div = <0x05>;
		clock-names = "main\0dma";
		clocks = <0x27 0x0b 0x27 0x26>;
		compatible = "mediatek,i2c";
		eh_cfg = <0x20>;
		gpio_start = <0x10002c00>;
		id = <0x06>;
		interrupts = <0x00 0x83 0x08>;
		linux,phandle = <0x90>;
		mediatek,hs_only;
		mem_len = <0x200>;
		phandle = <0x90>;
		pu_cfg = <0x50>;
		reg = <0x00 0x1100d000 0x00 0x1000 0x00 0x11000600 0x00 0x80>;
		rsel_cfg = <0x70>;
		scl-gpio-id = <0xa1>;
		sda-gpio-id = <0xa2>;
	};

	i2c7 {
		linux,phandle = <0xb1>;
		phandle = <0xb1>;
	};

	i2c8 {
		linux,phandle = <0xb2>;
		phandle = <0xb2>;
	};

	i2c9 {
		linux,phandle = <0xb3>;
		phandle = <0xb3>;
	};

	i2c_common {
		check_max_freq = [01];
		cnt_constraint = [01];
		compatible = "mediatek,i2c_common";
		dma_support = [02];
		ext_time_config = [18 01];
		idvfs = [01];
		linux,phandle = <0x89>;
		phandle = <0x89>;
		set_dt_div = [01];
		set_ltiming = [01];
		ver = [02];
	};

	imgsys@15020000 {
		#clock-cells = <0x01>;
		clock-names = "ISP_SCP_SYS_DIS\0ISP_SCP_SYS_ISP\0ISP_SCP_SYS_CAM\0ISP_CLK_IMG_DIP\0ISP_CLK_CAM\0ISP_CLK_CAMTG\0ISP_CLK_CAM_SENINF\0ISP_CLK_CAMSV0\0ISP_CLK_CAMSV1\0ISP_CLK_CAMSV2";
		clocks = <0x28 0x03 0x28 0x05 0x28 0x09 0x44 0x01 0x45 0x02 0x45 0x03 0x45 0x04 0x45 0x05 0x45 0x06 0x45 0x07>;
		compatible = "mediatek,imgsys\0syscon";
		linux,phandle = <0x44>;
		phandle = <0x44>;
		reg = <0x00 0x15020000 0x00 0x1000>;
	};

	imp_iic@11017000 {
		compatible = "mediatek,imp_iic";
		reg = <0x00 0x11017000 0x00 0x1000>;
	};

	infra_mbist@1020d000 {
		compatible = "mediatek,infra_mbist";
		reg = <0x00 0x1020d000 0x00 0x1000>;
	};

	infracfg@1020e000 {
		compatible = "mediatek,infracfg";
		reg = <0x00 0x1020e000 0x00 0x1000>;
	};

	infracfg_ao@10001000 {
		#clock-cells = <0x01>;
		compatible = "mediatek,infracfg_ao\0syscon";
		interrupts = <0x00 0x93 0x01>;
		linux,phandle = <0x27>;
		phandle = <0x27>;
		reg = <0x00 0x10001000 0x00 0x1000>;
	};

	interrupt-controller@0c000000 {
		#address-cells = <0x02>;
		#interrupt-cells = <0x03>;
		#redistributor-regions = <0x01>;
		#size-cells = <0x02>;
		compatible = "arm,gic-v3";
		interrupt-controller;
		interrupt-parent = <0x11>;
		interrupts = <0x01 0x09 0x04>;
		linux,phandle = <0x11>;
		phandle = <0x11>;
		reg = <0x00 0xc000000 0x00 0x40000 0x00 0xc100000 0x00 0x200000 0x00 0x10200a80 0x00 0x50>;
	};

	intpol-controller@10200a80 {
		#interrupt-cells = <0x03>;
		compatible = "mediatek,mt6577-sysirq";
		interrupt-controller;
		interrupt-parent = <0x11>;
		linux,phandle = <0x01>;
		phandle = <0x01>;
		reg = <0x00 0x10200a80 0x00 0x50>;
	};

	io_cfg_bl@10002600 {
		compatible = "mediatek,io_cfg_bl";
		reg = <0x00 0x10002600 0x00 0x200>;
	};

	io_cfg_lb@10002400 {
		compatible = "mediatek,io_cfg_lb";
		reg = <0x00 0x10002400 0x00 0x200>;
	};

	io_cfg_lm@10002200 {
		compatible = "mediatek,io_cfg_lm";
		reg = <0x00 0x10002200 0x00 0x200>;
	};

	io_cfg_lt@10002000 {
		compatible = "mediatek,io_cfg_lt";
		reg = <0x00 0x10002000 0x00 0x200>;
	};

	io_cfg_rb@10002a00 {
		compatible = "mediatek,io_cfg_rb";
		reg = <0x00 0x10002a00 0x00 0x200>;
	};

	io_cfg_rr@10002800 {
		compatible = "mediatek,io_cfg_rr";
		reg = <0x00 0x10002800 0x00 0x200>;
	};

	io_cfg_rt@10002c00 {
		compatible = "mediatek,io_cfg_rt";
		reg = <0x00 0x10002c00 0x00 0x200>;
	};

	iocfg_0@10002000 {
		compatible = "mediatek,iocfg_0";
		reg = <0x00 0x10002000 0x00 0x200>;
	};

	iocfg_1@10002200 {
		compatible = "mediatek,iocfg_1";
		reg = <0x00 0x10002200 0x00 0x200>;
	};

	iocfg_2@10002400 {
		compatible = "mediatek,iocfg_2";
		reg = <0x00 0x10002400 0x00 0x200>;
	};

	iocfg_3@10002600 {
		compatible = "mediatek,iocfg_3";
		reg = <0x00 0x10002600 0x00 0x200>;
	};

	iocfg_4@10002800 {
		compatible = "mediatek,iocfg_4";
		reg = <0x00 0x10002800 0x00 0x200>;
	};

	iocfg_5@10002a00 {
		compatible = "mediatek,iocfg_5";
		reg = <0x00 0x10002a00 0x00 0x200>;
	};

	irq_nfc {
		compatible = "mediatek,irq_nfc-eint";
		linux,phandle = <0xa0>;
		phandle = <0xa0>;
	};

	irtx_pwm {
		compatible = "mediatek,irtx-pwm";
		linux,phandle = <0xad>;
		phandle = <0xad>;
		pwm_ch = <0x00>;
		pwm_data_invert = <0x00>;
	};

	kd_camera_hw1@1a040000 {
		clock-names = "CLK_TOP_CAMTG_SEL\0CLK_TOP_CAMTG1_SEL\0CLK_TOP_CAMTG2_SEL\0CLK_TOP_CAMTG3_SEL\0CLK_MCLK_6M\0CLK_MCLK_12M\0CLK_MCLK_13M\0CLK_MCLK_48M\0CLK_MCLK_52M\0CLK_MCLK_24M\0CLK_MCLK_26M\0CLK_CAM_SENINF_CG\0CLK_MIPI_C0_26M_CG\0CLK_MIPI_C1_26M_CG\0CLK_MIPI_ANA_0A_CG\0CLK_MIPI_ANA_0B_CG\0CLK_MIPI_ANA_1A_CG\0CLK_MIPI_ANA_1B_CG\0CLK_MIPI_ANA_2A_CG\0CLK_MIPI_ANA_2B_CG\0CLK_TOP_CAMTM_SEL_CG\0CLK_TOP_CAMTM_208_CG\0CLK_SCP_SYS_CAM";
		clocks = <0x1e 0x66 0x1e 0x67 0x1e 0x68 0x1e 0x69 0x1e 0x14 0x1e 0x13 0x1e 0x1d 0x1e 0x11 0x1e 0x1c 0x1e 0x12 0x1f 0x45 0x04 0x43 0x0e 0x43 0x12 0x47 0x00 0x48 0x00 0x49 0x00 0x4a 0x00 0x4b 0x00 0x4c 0x00 0x1e 0x7d 0x1e 0x1a 0x28 0x09>;
		compatible = "mediatek,camera_hw";
		linux,phandle = <0xa3>;
		phandle = <0xa3>;
		reg = <0x00 0x1a040000 0x00 0x1000>;
	};

	kp@10010000 {
		compatible = "mediatek,kp";
		interrupts = <0x00 0xb4 0x02>;
		linux,phandle = <0x1a>;
		phandle = <0x1a>;
		reg = <0x00 0x10010000 0x00 0x1000>;
	};

	l2c_parity {
		compatible = "mediatek,l2c_parity-v1";
		interrupts = <0x00 0x18 0x04 0x00 0x19 0x04>;
	};

	lcm {
		compatible = "mediatek,lcm_mode";
		linux,phandle = <0x7f>;
		phandle = <0x7f>;
	};

	lk_charger {
		ac_charger_current = <0x668a0>;
		ac_charger_input_current = <0x1e8480>;
		charging_host_charger_current = <0x668a0>;
		compatible = "mediatek,lk_charger";
		enable_anime;
		fast_charge_voltage = <0x2f4d60>;
		linux,phandle = <0xa8>;
		max_charger_voltage = <0x588040>;
		non_std_ac_charger_current = <0x61a80>;
		pd_charger_current = <0x7a120>;
		phandle = <0xa8>;
		power_path_support;
		ta_ac_charger_current = <0x2dc6c0>;
		temp_t1_threshold = <0x00>;
		temp_t3_threshold = <0x2d>;
		temp_t4_threshold = <0x32>;
		usb_charger_current = <0x668a0>;
	};

	m4u@10205000 {
		#iommu-cells = <0x01>;
		cell-index = <0x00>;
		compatible = "mediatek,iommu_v0";
		interrupts = <0x00 0x9e 0x08>;
		linux,phandle = <0x53>;
		mediatek,larbs = <0x23 0x24 0x25 0x26>;
		phandle = <0x53>;
		reg = <0x00 0x10205000 0x00 0x1000>;
	};

	mbist@17050000 {
		compatible = "mediatek,mbist";
		reg = <0x00 0x17050000 0x00 0x10000>;
	};

	mbist_ao@10013000 {
		compatible = "mediatek,mbist_ao";
		reg = <0x00 0x10013000 0x00 0x1000>;
	};

	mcdi@0010fc00 {
		compatible = "mediatek,mt6765-mcdi";
		reg = <0x00 0x10fc00 0x00 0x800>;
	};

	mcucfg@10200000 {
		compatible = "mediatek,mcucfg";
		interrupts = <0x00 0x00 0x08>;
		reg = <0x00 0x10200000 0x00 0x1000>;
	};

	mcucfg_mp0_counter@10200000 {
		compatible = "mediatek,mcucfg_mp0_counter";
		reg = <0x00 0x10200000 0x00 0x4000>;
	};

	mcupm_reg@10216000 {
		compatible = "mediatek,mcupm_reg";
		reg = <0x00 0x10216000 0x00 0x1000>;
	};

	mcupm_sram0@10217000 {
		compatible = "mediatek,mcupm_sram0";
		reg = <0x00 0x10217000 0x00 0x1000>;
	};

	mcupm_sram1@10218000 {
		compatible = "mediatek,mcupm_sram1";
		reg = <0x00 0x10218000 0x00 0x1000>;
	};

	mcupm_sram2@10211000 {
		compatible = "mediatek,mcupm_sram2";
		reg = <0x00 0x10211000 0x00 0x1000>;
	};

	mcupm_sram3@10213000 {
		compatible = "mediatek,mcupm_sram3";
		reg = <0x00 0x10213000 0x00 0x1000>;
	};

	md1_sim1_hot_plug_eint {
		linux,phandle = <0xb8>;
		phandle = <0xb8>;
	};

	md1_sim2_hot_plug_eint {
		linux,phandle = <0xb9>;
		phandle = <0xb9>;
	};

	md_ccif0@1020a000 {
		compatible = "mediatek,md_ccif0";
		reg = <0x00 0x1020a000 0x00 0x1000>;
	};

	md_ccif1@1020c000 {
		compatible = "mediatek,md_ccif1";
		reg = <0x00 0x1020c000 0x00 0x1000>;
	};

	md_ccif2@1023d000 {
		compatible = "mediatek,md_ccif2";
		reg = <0x00 0x1023d000 0x00 0x1000>;
	};

	md_ccif3@1023f000 {
		compatible = "mediatek,md_ccif3";
		reg = <0x00 0x1023f000 0x00 0x1000>;
	};

	mdcldma@10014000 {
		clock-names = "scp-sys-md1-main\0infra-cldma-bclk\0infra-ccif-ap\0infra-ccif-md\0infra-ccif1-ap\0infra-ccif1-md\0infra-ccif2-ap\0infra-ccif2-md";
		clocks = <0x28 0x00 0x27 0x32 0x27 0x29 0x27 0x2c 0x27 0x23 0x27 0x24 0x27 0x51 0x27 0x52>;
		compatible = "mediatek,mdcldma";
		interrupts = <0x00 0xa5 0x04 0x00 0x94 0x08 0x00 0x95 0x08 0x00 0x105 0x02>;
		linux,phandle = <0x1c>;
		mediatek,cldma_capability = <0x06>;
		mediatek,md_id = <0x00>;
		phandle = <0x1c>;
		reg = <0x00 0x10014000 0x00 0x1000 0x00 0x1021b000 0x00 0x1000 0x00 0x10209000 0x00 0x1000 0x00 0x1020a000 0x00 0x1000>;
	};

	mdcldmain@1021c000 {
		compatible = "mediatek,mdcldmain";
		reg = <0x00 0x1021c000 0x00 0x400>;
	};

	mdcldmain_ao@10015000 {
		compatible = "mediatek,mdcldmain_ao";
		reg = <0x00 0x10015000 0x00 0x400>;
	};

	mdcldmamisc@1021c800 {
		compatible = "mediatek,mdcldmamisc";
		reg = <0x00 0x1021c800 0x00 0x1000>;
	};

	mdcldmamisc_ao@10015800 {
		compatible = "mediatek,mdcldmamisc_ao";
		reg = <0x00 0x10015800 0x00 0x400>;
	};

	mdcldmaout@1021c400 {
		compatible = "mediatek,mdcldmaout";
		reg = <0x00 0x1021c400 0x00 0x400>;
	};

	mdcldmaout_ao@10015400 {
		compatible = "mediatek,mdcldmaout_ao";
		reg = <0x00 0x10015400 0x00 0x400>;
	};

	mdp_ccorr0@14005000 {
		clock-names = "MDP_CCORR";
		clocks = <0x29 0x01>;
		compatible = "mediatek,mdp_ccorr0";
		interrupts = <0x00 0xe2 0x08>;
		linux,phandle = <0x31>;
		phandle = <0x31>;
		reg = <0x00 0x14005000 0x00 0x1000>;
	};

	mdp_rdma0@14004000 {
		clock-names = "MDP_RDMA0";
		clocks = <0x29 0x00>;
		compatible = "mediatek,mdp_rdma0";
		interrupts = <0x00 0xd3 0x08>;
		linux,phandle = <0x2a>;
		phandle = <0x2a>;
		reg = <0x00 0x14004000 0x00 0x1000>;
	};

	mdp_rsz0@14006000 {
		clock-names = "MDP_RSZ0";
		clocks = <0x29 0x02>;
		compatible = "mediatek,mdp_rsz0";
		interrupts = <0x00 0xd4 0x08>;
		linux,phandle = <0x2b>;
		phandle = <0x2b>;
		reg = <0x00 0x14006000 0x00 0x1000>;
	};

	mdp_rsz1@14007000 {
		clock-names = "MDP_RSZ1";
		clocks = <0x29 0x03>;
		compatible = "mediatek,mdp_rsz1";
		interrupts = <0x00 0xd5 0x08>;
		linux,phandle = <0x2c>;
		phandle = <0x2c>;
		reg = <0x00 0x14007000 0x00 0x1000>;
	};

	mdp_tdshp0@1400a000 {
		clock-names = "MDP_TDSHP";
		clocks = <0x29 0x04>;
		compatible = "mediatek,mdp_tdshp0";
		linux,phandle = <0x2f>;
		phandle = <0x2f>;
		reg = <0x00 0x1400a000 0x00 0x1000>;
	};

	mdp_wdma0@14008000 {
		clock-names = "MDP_WDMA";
		clocks = <0x29 0x06>;
		compatible = "mediatek,mdp_wdma0";
		interrupts = <0x00 0xd8 0x08>;
		linux,phandle = <0x2d>;
		phandle = <0x2d>;
		reg = <0x00 0x14008000 0x00 0x1000>;
	};

	mdp_wrot0@14009000 {
		clock-names = "MDP_WROT0";
		clocks = <0x29 0x05>;
		compatible = "mediatek,mdp_wrot0";
		interrupts = <0x00 0xd7 0x08>;
		linux,phandle = <0x2e>;
		phandle = <0x2e>;
		reg = <0x00 0x14009000 0x00 0x1000>;
	};

	memory {
		device_type = "memory";
		reg = <0x00 0x40000000 0x00 0x20000000>;
	};

	memory-ssmr-features {
		2d_fr-size = <0x00 0x8000000>;
		compatible = "mediatek,memory-ssmr-features";
		iris-recognition-size = <0x00 0x10000000>;
		linux,phandle = <0xaf>;
		phandle = <0xaf>;
		prot-sharedmem-size = <0x00 0x8000000>;
		sdsp-firmware-size = <0x00 0x1000000>;
		sdsp-tee-sharedmem-size = <0x00 0x1000000>;
		svp-size = <0x00 0x10000000>;
		ta-elf-size = <0x00 0x1000000>;
		ta-stack-heap-size = <0x00 0x6000000>;
		tui-size = <0x00 0x4000000>;
		wfd-size = <0x00 0x4000000>;
	};

	mfg_cfg@13ffe000 {
		#clock-cells = <0x01>;
		compatible = "mediatek,mfgcfg\0syscon";
		linux,phandle = <0x9e>;
		phandle = <0x9e>;
		reg = <0x00 0x13ffe000 0x00 0x1000>;
	};

	mfg_doma@13000000 {
		clock-frequency = <0x21f98280>;
		compatible = "mediatek,doma";
		interrupt-names = "RGX";
		interrupts = <0x00 0x103 0x08>;
		reg = <0x00 0x13000000 0x00 0x80000>;
	};

	mipi_rx_ana_csi0a@11c10000 {
		#clock-cells = <0x01>;
		compatible = "mediatek,mipi_rx_ana_csi0a\0syscon";
		linux,phandle = <0x47>;
		phandle = <0x47>;
		reg = <0x00 0x11c10000 0x00 0x1000>;
	};

	mipi_rx_ana_csi0b@11c11000 {
		#clock-cells = <0x01>;
		compatible = "mediatek,mipi_rx_ana_csi0b\0syscon";
		linux,phandle = <0x48>;
		phandle = <0x48>;
		reg = <0x00 0x11c11000 0x00 0x1000>;
	};

	mipi_rx_ana_csi1a@11c12000 {
		#clock-cells = <0x01>;
		compatible = "mediatek,mipi_rx_ana_csi1a\0syscon";
		linux,phandle = <0x49>;
		phandle = <0x49>;
		reg = <0x00 0x11c12000 0x00 0x1000>;
	};

	mipi_rx_ana_csi1b@11c13000 {
		#clock-cells = <0x01>;
		compatible = "mediatek,mipi_rx_ana_csi1b\0syscon";
		linux,phandle = <0x4a>;
		phandle = <0x4a>;
		reg = <0x00 0x11c13000 0x00 0x1000>;
	};

	mipi_rx_ana_csi2a@11c14000 {
		#clock-cells = <0x01>;
		compatible = "mediatek,mipi_rx_ana_csi2a\0syscon";
		linux,phandle = <0x4b>;
		phandle = <0x4b>;
		reg = <0x00 0x11c14000 0x00 0x1000>;
	};

	mipi_rx_ana_csi2b@11c15000 {
		#clock-cells = <0x01>;
		compatible = "mediatek,mipi_rx_ana_csi2b\0syscon";
		linux,phandle = <0x4c>;
		phandle = <0x4c>;
		reg = <0x00 0x11c15000 0x00 0x1000>;
	};

	mipi_tx0@11c80000 {
		compatible = "mediatek,mipi_tx0";
		reg = <0x00 0x11c80000 0x00 0x10000>;
	};

	mmdvfs_pmqos {
		cam_freq = "mm_step0\0mm_step1\0mm_step2";
		clock-names = "mmdvfs_clk_mm_sel_ck\0mmdvfs_clk_mmpll_ck\0mmdvfs_clk_univpll1_d2_ck\0mmdvfs_clk_mmpll_d2_ck";
		clocks = <0x1e 0x62 0x1e 0x21 0x1e 0x17 0x1e 0x22>;
		compatible = "mediatek,mmdvfs_pmqos";
		disp_freq = "mm_step0\0mm_step1\0mm_step2";
		img_freq = "mm_step0\0mm_step1\0mm_step2";
		mdp_freq = "mm_step0\0mm_step1\0mm_step2";
		mm_step0 = <0x1c9 0x01 0x00 0x01>;
		mm_step1 = <0x138 0x01 0x00 0x02>;
		mm_step2 = <0xe4 0x01 0x00 0x03>;
		vdec_freq = "mm_step0\0mm_step1\0mm_step2";
		venc_freq = "mm_step0\0mm_step1\0mm_step2";
		vopp_steps = <0x00 0x01 0x03>;
	};

	mmsys_config@14000000 {
		#clock-cells = <0x01>;
		clock-names = "CAM_MDP\0IMG_DL_RELAY\0IMG_DL_ASYNC_TOP";
		clocks = <0x29 0x17 0x29 0x1a 0x29 0x1b>;
		compatible = "mediatek,mmsys_config\0syscon";
		interrupts = <0x00 0xe3 0x08>;
		linux,phandle = <0x29>;
		phandle = <0x29>;
		reg = <0x00 0x14000000 0x00 0x1000>;
	};

	mobicore {
		compatible = "trustonic,mobicore";
		interrupts = <0x00 0x10f 0x01>;
	};

	modem_temp_share@10018000 {
		compatible = "mediatek,modem_temp_share";
		reg = <0x00 0x10018000 0x00 0x1000>;
	};

	mrdump_ext_rst {
		compatible = "mediatek, mrdump_ext_rst-eint";
		force_mode = "EINT";
		linux,phandle = <0x7c>;
		mode = "IRQ";
		phandle = <0x7c>;
		status = "okay";
	};

	msdc0_pad_macro@11cd0000 {
		compatible = "mediatek,msdc0_pad_macro";
		reg = <0x00 0x11cd0000 0x00 0x10000>;
	};

	msdc0_top@11cd0000 {
		compatible = "mediatek,msdc0_top";
		reg = <0x00 0x11cd0000 0x00 0x1000>;
	};

	msdc1_ins@0 {
		compatible = "mediatek,mt6765-sdcard-ins";
		linux,phandle = <0x9c>;
		phandle = <0x9c>;
	};

	msdc1_pad_macro@11c90000 {
		compatible = "mediatek,msdc1_pad_macro";
		reg = <0x00 0x11c90000 0x00 0x10000>;
	};

	msdc1_top@11c90000 {
		compatible = "mediatek,msdc1_top";
		reg = <0x00 0x11c90000 0x00 0x1000>;
	};

	msdc@11230000 {
		bootable;
		bus-width = <0x08>;
		cap-mmc-highspeed;
		clk_src = [01];
		clock-names = "msdc0-clock\0msdc0-hclock\0msdc0-aes-clock";
		clocks = <0x27 0x4c 0x27 0x1c 0x27 0x44>;
		compatible = "mediatek,msdc";
		host_function = [00];
		index = [00];
		interrupts = <0x00 0x4f 0x08>;
		linux,phandle = <0x98>;
		max-frequency = <0xbebc200>;
		mmc-ddr-1_8v;
		mmc-hs200-1_8v;
		mmc-hs400-1_8v;
		no-sd;
		no-sdio;
		non-removable;
		phandle = <0x98>;
		pinctl = <0x35>;
		pinctl_hs200 = <0x37>;
		pinctl_hs400 = <0x36>;
		reg = <0x00 0x11230000 0x00 0x10000>;
		register_setting = <0x38>;
		status = "okay";
		vmmc-supply = <0x39>;
	};

	msdc@11240000 {
		bus-width = <0x04>;
		cap-sd-highspeed;
		cd-gpios = <0x20 0x01 0x00>;
		cd_level = [01];
		clk_src = [02];
		clock-names = "msdc1-clock\0msdc1-hclock";
		clocks = <0x27 0x4d 0x27 0x1d>;
		compatible = "mediatek,msdc";
		host_function = [01];
		index = [01];
		interrupts = <0x00 0x50 0x08>;
		linux,phandle = <0x99>;
		max-frequency = <0xbebc200>;
		no-mmc;
		no-sdio;
		phandle = <0x99>;
		pinctl = <0x3a>;
		pinctl_ddr50 = <0x3d>;
		pinctl_sdr104 = <0x3b>;
		pinctl_sdr50 = <0x3c>;
		reg = <0x00 0x11240000 0x00 0x10000>;
		register_setting = <0x3e>;
		sd-uhs-ddr50;
		sd-uhs-sdr104;
		sd-uhs-sdr12;
		sd-uhs-sdr25;
		sd-uhs-sdr50;
		status = "okay";
		vmmc-supply = <0x3f>;
		vqmmc-supply = <0x40>;
	};

	msdc@11250000 {
		compatible = "mediatek,msdc2";
		linux,phandle = <0x9a>;
		phandle = <0x9a>;
		reg = <0x00 0x11250000 0x00 0x10000>;
		status = "disable";
	};

	msdc@11260000 {
		compatible = "mediatek,msdc3";
		linux,phandle = <0x9b>;
		phandle = <0x9b>;
		reg = <0x00 0x11250000 0x00 0x10000>;
		status = "disable";
	};

	mt-pmic {
		compatible = "mediatek,mt_pmic";
		interrupt-controller;
		linux,phandle = <0x5c>;
		phandle = <0x5c>;

		buck_regulators {

			buck_vcore {
				linux,phandle = <0x60>;
				phandle = <0x60>;
				regulator-enable-ramp-delay = <0xdc>;
				regulator-max-microvolt = <0x1406f4>;
				regulator-min-microvolt = <0x7ea5e>;
				regulator-name = "vcore";
				regulator-ramp-delay = <0x186a>;
			};

			buck_vmodem {
				linux,phandle = <0x5f>;
				phandle = <0x5f>;
				regulator-enable-ramp-delay = <0xdc>;
				regulator-max-microvolt = <0x123716>;
				regulator-min-microvolt = <0x7a120>;
				regulator-name = "vmodem";
				regulator-ramp-delay = <0x186a>;
			};

			buck_vpa {
				linux,phandle = <0x62>;
				phandle = <0x62>;
				regulator-enable-ramp-delay = <0xdc>;
				regulator-max-microvolt = <0x37b1d0>;
				regulator-min-microvolt = <0x7a120>;
				regulator-name = "vpa";
				regulator-ramp-delay = <0xc350>;
			};

			buck_vproc {
				linux,phandle = <0x61>;
				phandle = <0x61>;
				regulator-enable-ramp-delay = <0xdc>;
				regulator-max-microvolt = <0x1406f4>;
				regulator-min-microvolt = <0x7ea5e>;
				regulator-name = "vproc";
				regulator-ramp-delay = <0x186a>;
			};

			buck_vs1 {
				linux,phandle = <0x5e>;
				phandle = <0x5e>;
				regulator-enable-ramp-delay = <0xdc>;
				regulator-max-microvolt = <0x2191c0>;
				regulator-min-microvolt = <0x124f80>;
				regulator-name = "vs1";
				regulator-ramp-delay = <0x30d4>;
			};
		};

		ldo_regulators {

			ldo_vaud28 {
				compatible = "regulator-fixed";
				linux,phandle = <0x73>;
				phandle = <0x73>;
				regulator-enable-ramp-delay = <0x108>;
				regulator-max-microvolt = <0x2ab980>;
				regulator-min-microvolt = <0x2ab980>;
				regulator-name = "vaud28";
			};

			ldo_vaux18 {
				compatible = "regulator-fixed";
				linux,phandle = <0x72>;
				phandle = <0x72>;
				regulator-enable-ramp-delay = <0x108>;
				regulator-max-microvolt = <0x1b7740>;
				regulator-min-microvolt = <0x1b7740>;
				regulator-name = "vaux18";
			};

			ldo_vcama {
				linux,phandle = <0x6c>;
				phandle = <0x6c>;
				regulator-enable-ramp-delay = <0x108>;
				regulator-max-microvolt = <0x2ab980>;
				regulator-min-microvolt = <0x2625a0>;
				regulator-name = "vcama";
			};

			ldo_vcamd {
				linux,phandle = <0x6d>;
				phandle = <0x6d>;
				regulator-enable-ramp-delay = <0x108>;
				regulator-max-microvolt = <0x1b7740>;
				regulator-min-microvolt = <0xf4240>;
				regulator-name = "vcamd";
			};

			ldo_vcamio {
				compatible = "regulator-fixed";
				linux,phandle = <0x6e>;
				phandle = <0x6e>;
				regulator-enable-ramp-delay = <0x108>;
				regulator-max-microvolt = <0x1b7740>;
				regulator-min-microvolt = <0x1b7740>;
				regulator-name = "vcamio";
			};

			ldo_vcn18 {
				compatible = "regulator-fixed";
				linux,phandle = <0x6b>;
				phandle = <0x6b>;
				regulator-enable-ramp-delay = <0x108>;
				regulator-max-microvolt = <0x1b7740>;
				regulator-min-microvolt = <0x1b7740>;
				regulator-name = "vcn18";
			};

			ldo_vcn28 {
				compatible = "regulator-fixed";
				linux,phandle = <0x6a>;
				phandle = <0x6a>;
				regulator-enable-ramp-delay = <0x108>;
				regulator-max-microvolt = <0x2ab980>;
				regulator-min-microvolt = <0x2ab980>;
				regulator-name = "vcn28";
			};

			ldo_vcn33_bt {
				linux,phandle = <0x68>;
				phandle = <0x68>;
				regulator-enable-ramp-delay = <0x108>;
				regulator-max-microvolt = <0x3567e0>;
				regulator-min-microvolt = <0x325aa0>;
				regulator-name = "vcn33_bt";
			};

			ldo_vcn33_wifi {
				linux,phandle = <0x69>;
				phandle = <0x69>;
				regulator-enable-ramp-delay = <0x108>;
				regulator-max-microvolt = <0x3567e0>;
				regulator-min-microvolt = <0x325aa0>;
				regulator-name = "vcn33_wifi";
			};

			ldo_vdram {
				linux,phandle = <0x76>;
				phandle = <0x76>;
				regulator-enable-ramp-delay = <0xce4>;
				regulator-max-microvolt = <0x124f80>;
				regulator-min-microvolt = <0x10c8e0>;
				regulator-name = "vdram";
			};

			ldo_vefuse {
				linux,phandle = <0x67>;
				phandle = <0x67>;
				regulator-enable-ramp-delay = <0x108>;
				regulator-max-microvolt = <0x325aa0>;
				regulator-min-microvolt = <0x124f80>;
				regulator-name = "vefuse";
			};

			ldo_vemc {
				linux,phandle = <0x39>;
				phandle = <0x39>;
				regulator-enable-ramp-delay = <0x2c>;
				regulator-max-microvolt = <0x325aa0>;
				regulator-min-microvolt = <0x2c4020>;
				regulator-name = "vemc";
			};

			ldo_vfe28 {
				compatible = "regulator-fixed";
				linux,phandle = <0x63>;
				phandle = <0x63>;
				regulator-enable-ramp-delay = <0x108>;
				regulator-max-microvolt = <0x2ab980>;
				regulator-min-microvolt = <0x2ab980>;
				regulator-name = "vfe28";
			};

			ldo_vibr {
				linux,phandle = <0x79>;
				phandle = <0x79>;
				regulator-enable-ramp-delay = <0x2c>;
				regulator-max-microvolt = <0x325aa0>;
				regulator-min-microvolt = <0x124f80>;
				regulator-name = "vibr";
			};

			ldo_vio18 {
				compatible = "regulator-fixed";
				linux,phandle = <0x75>;
				phandle = <0x75>;
				regulator-enable-ramp-delay = <0x108>;
				regulator-max-microvolt = <0x1b7740>;
				regulator-min-microvolt = <0x1b7740>;
				regulator-name = "vio18";
			};

			ldo_vio28 {
				compatible = "regulator-fixed";
				linux,phandle = <0x74>;
				phandle = <0x74>;
				regulator-enable-ramp-delay = <0x108>;
				regulator-max-microvolt = <0x2ab980>;
				regulator-min-microvolt = <0x2ab980>;
				regulator-name = "vio28";
			};

			ldo_vldo28 {
				linux,phandle = <0x6f>;
				phandle = <0x6f>;
				regulator-enable-ramp-delay = <0x108>;
				regulator-max-microvolt = <0x2dc6c0>;
				regulator-min-microvolt = <0x2ab980>;
				regulator-name = "vldo28";
			};

			ldo_vmc {
				linux,phandle = <0x40>;
				phandle = <0x40>;
				regulator-enable-ramp-delay = <0x2c>;
				regulator-max-microvolt = <0x325aa0>;
				regulator-min-microvolt = <0x1b7740>;
				regulator-name = "vmc";
			};

			ldo_vmch {
				linux,phandle = <0x3f>;
				phandle = <0x3f>;
				regulator-enable-ramp-delay = <0x2c>;
				regulator-max-microvolt = <0x325aa0>;
				regulator-min-microvolt = <0x2c4020>;
				regulator-name = "vmch";
			};

			ldo_vrf12 {
				compatible = "regulator-fixed";
				linux,phandle = <0x66>;
				phandle = <0x66>;
				regulator-enable-ramp-delay = <0x6e>;
				regulator-max-microvolt = <0x124f80>;
				regulator-min-microvolt = <0x124f80>;
				regulator-name = "vrf12";
			};

			ldo_vrf18 {
				compatible = "regulator-fixed";
				linux,phandle = <0x65>;
				phandle = <0x65>;
				regulator-enable-ramp-delay = <0x6e>;
				regulator-max-microvolt = <0x1b7740>;
				regulator-min-microvolt = <0x1b7740>;
				regulator-name = "vrf18";
			};

			ldo_vsim1 {
				linux,phandle = <0x77>;
				phandle = <0x77>;
				regulator-enable-ramp-delay = <0x108>;
				regulator-max-microvolt = <0x2f4d60>;
				regulator-min-microvolt = <0x19f0a0>;
				regulator-name = "vsim1";
			};

			ldo_vsim2 {
				linux,phandle = <0x78>;
				phandle = <0x78>;
				regulator-enable-ramp-delay = <0x108>;
				regulator-max-microvolt = <0x2f4d60>;
				regulator-min-microvolt = <0x19f0a0>;
				regulator-name = "vsim2";
			};

			ldo_vsram_others {
				linux,phandle = <0x70>;
				phandle = <0x70>;
				regulator-enable-ramp-delay = <0x6e>;
				regulator-max-microvolt = <0x1406f4>;
				regulator-min-microvolt = <0x7ea5e>;
				regulator-name = "vsram_others";
				regulator-ramp-delay = <0x186a>;
			};

			ldo_vsram_proc {
				linux,phandle = <0x71>;
				phandle = <0x71>;
				regulator-enable-ramp-delay = <0x6e>;
				regulator-max-microvolt = <0x1406f4>;
				regulator-min-microvolt = <0x7ea5e>;
				regulator-name = "vsram_proc";
				regulator-ramp-delay = <0x186a>;
			};

			ldo_vusb33 {
				linux,phandle = <0x7a>;
				phandle = <0x7a>;
				regulator-enable-ramp-delay = <0x108>;
				regulator-max-microvolt = <0x2f4d60>;
				regulator-min-microvolt = <0x2dc6c0>;
				regulator-name = "vusb33";
			};

			ldo_vxo22 {
				linux,phandle = <0x64>;
				phandle = <0x64>;
				regulator-enable-ramp-delay = <0x6e>;
				regulator-max-microvolt = <0x249f00>;
				regulator-min-microvolt = <0x2191c0>;
				regulator-name = "vxo22";
			};
		};

		mt635x-auxadc {
			#io-channel-cells = <0x01>;
			compatible = "mediatek,mt635x-auxadc";
			linux,phandle = <0x5d>;
			phandle = <0x5d>;

			accdet {
				channel = <0x09>;
			};

			bat_temp {
				channel = <0x03>;
				resistance-ratio = <0x01 0x01>;
			};

			batadc {
				avg-num = <0x80>;
				channel = <0x00>;
				resistance-ratio = <0x03 0x01>;
			};

			chip_temp {
				channel = <0x05>;
			};

			dcxo_temp {
				avg-num = <0x10>;
				channel = <0x0d>;
			};

			hpofs_cal {
				avg-num = <0x100>;
				channel = <0x0c>;
			};

			isense {
				avg-num = <0x80>;
				channel = <0x01>;
				resistance-ratio = <0x03 0x01>;
			};

			tsx_temp {
				avg-num = <0x80>;
				channel = <0x0b>;
			};

			vbif {
				channel = <0x0e>;
				resistance-ratio = <0x01 0x01>;
			};

			vcdt {
				channel = <0x02>;
			};

			vcore_temp {
				channel = <0x06>;
			};

			vproc_temp {
				channel = <0x07>;
			};
		};
	};

	mt6357_gauge {
		alias_name = "mt6357";
		compatible = "mediatek,mt6357_gauge";
		gauge_name = "gauge";
	};

	mt6370_pd_eint {
		linux,phandle = <0xac>;
		phandle = <0xac>;
	};

	mt6370_pmu_dts {
		#interrupt-cells = <0x01>;
		interrupt-controller;
		linux,phandle = <0xbc>;
		mt6370,intr_gpio = <0x20 0x03 0x00>;
		mt6370,intr_gpio_num = <0x03>;
		phandle = <0xbc>;

		bled {
			compatible = "mediatek,mt6370_pmu_bled";
			interrupt-names = "bled_ocp";
			mt,bl_ocp_level = <0x02>;
			mt,bl_ovp_level = <0x03>;
			mt,bled_flash_ramp = <0x01>;
			mt,bled_name = "mt6370_pmu_bled";
			mt,bled_ramptime = <0x03>;
			mt,chan_en = <0x0f>;
			mt,map_linear;
			mt,max_bled_brightness = <0x200>;
			mt,pwm_avg_cycle = <0x00>;
			mt,pwm_deglitch = <0x01>;
			mt,pwm_fsample = <0x02>;
			mt,pwm_hys = <0x00>;
			mt,pwm_hys_en = <0x01>;
			mt,use_pwm;
		};

		charger {
			aicr = <0x7a120>;
			charger_name = "primary_chg";
			compatible = "mediatek,mt6370_pmu_charger";
			cv = <0x426030>;
			dc_wdt = "\0=\t";
			enable_te;
			enable_wdt;
			ichg = <0x1e8480>;
			ieoc = <0x249f0>;
			interrupt-names = "chg_mivr\0chg_aiclmeasi\0attachi\0ovpctrl_uvp_d_evt\0chg_wdtmri\0chg_vbusov\0chg_tmri\0chg_treg";
			ircmp_resistor = <0x61a8>;
			ircmp_vclamp = <0x7d00>;
			load_switch_name = "primary_load_switch";
			mivr = <0x432380>;
			safety_timer = <0x0c>;
		};

		core {
			compatible = "mediatek,mt6370_pmu_core";
			i2cstmr_rst_tmr = <0x00>;
			int_deg = <0x00>;
			int_wdt = <0x00>;
			interrupt-names = "otp\0vdda_ovp\0vdda_uv";
			mrstb_en;
			mrstb_tmr = <0x03>;
		};

		dsv {
			compatible = "mediatek,mt6370_pmu_dsv";
			db_delay = <0x03>;
			db_ext_en = <0x00>;
			db_freq_pm = <0x00>;
			db_periodic_fix = <0x00>;
			db_periodic_mode = <0x00>;
			db_single_pin = <0x00>;
			db_startup = <0x00>;
			db_vbst = <0x1644>;
			db_vneg_20ms = <0x01>;
			db_vneg_disc = <0x00>;
			db_vneg_slew = <0x01>;
			db_vpos_20ms = <0x01>;
			db_vpos_disc = <0x01>;
			db_vpos_slew = <0x01>;
			interrupt-names = "dsv_vneg_ocp\0dsv_vpos_ocp\0dsv_bst_ocp\0dsv_vneg_scp\0dsv_vpos_scp";

			mt6370_dsvn {
				regulator-max-microvolt = <0x5b8d80>;
				regulator-min-microvolt = "\0=\t";
				regulator-name = "dsv_neg";
			};

			mt6370_dsvp {
				regulator-max-microvolt = <0x5b8d80>;
				regulator-min-microvolt = "\0=\t";
				regulator-name = "dsv_pos";
			};
		};

		ldo {
			compatible = "mediatek,mt6370_pmu_ldo";
			interrupt-names = "ldo_oc";
			ldo_oms = <0x01>;
			ldo_vrc_lt = <0x01>;

			mt6370_ldo {
				regulator-max-microvolt = "\0=\t";
				regulator-min-microvolt = <0x186a00>;
				regulator-name = "irtx_ldo";
			};
		};

		mt6370_pmu_fled1 {
			compatible = "mediatek,mt6370_pmu_fled1";
			fled_enable = <0x01>;
			interrupt-names = "fled_lvf\0fled2_short\0fled1_short";
			strobe_cur = <0x124f80>;
			strobe_timeout = <0x960>;
			torch_cur = <0x493e0>;
		};

		mt6370_pmu_fled2 {
			compatible = "mediatek,mt6370_pmu_fled2";
			fled_enable = <0x01>;
			strobe_cur = <0xf4240>;
			strobe_timeout = <0x4b0>;
			torch_cur = <0x30d40>;
		};

		rgbled {
			compatible = "mediatek,mt6370_pmu_rgbled";
			interrupt-names = "isink4_short\0isink3_short\0isink2_short\0isink1_short\0isink4_open\0isink3_open\0isink2_open\0isink1_open";
			mt,led_default_trigger = "cc_mode\0cc_mode\0cc_mode\0none";
			mt,led_name = "mt6370_pmu_led1\0mt6370_pmu_led2\0mt6370_pmu_led3\0mt6370_pmu_led4";
		};
	};

	mt6370_pmu_eint {
		linux,phandle = <0xab>;
		phandle = <0xab>;
	};

	mt_charger {
		compatible = "mediatek,mt-charger";
		linux,phandle = <0xa7>;
		phandle = <0xa7>;
	};

	mt_soc_anc_pcm {
		compatible = "mediatek,mt_soc_pcm_anc";
	};

	mt_soc_codec_dummy_name {
		compatible = "mediatek,mt_soc_codec_dummy";
	};

	mt_soc_codec_name {
		accdec_hp_impedance_get = <0x00>;
		compatible = "mediatek,mt_soc_codec_63xx";
		use_hp_depop_flow = <0x00>;
		use_ul_260k = <0x00>;
	};

	mt_soc_dai_name {
		compatible = "mediatek,mt_soc_dai_stub";
	};

	mt_soc_deep_buffer_dl_pcm {
		compatible = "mediatek,mt_soc_pcm_deep_buffer_dl";
	};

	mt_soc_dl1_awb_pcm {
		compatible = "mediatek,mt_soc_pcm_dl1_awb";
	};

	mt_soc_dl1_pcm@11220000 {
		clock-names = "aud_afe_clk\0aud_dac_clk\0aud_dac_predis_clk\0aud_adc_clk\0aud_apll22m_clk\0aud_apll1_tuner_clk\0aud_tml_clk\0aud_infra_clk\0mtkaif_26m_clk\0top_mux_audio\0top_mux_audio_int\0top_sys_pll1_d4\0top_mux_aud_1\0top_apll1_ck\0top_mux_aud_eng1\0top_apll1_d8\0apmixed_apll1\0top_clk26m_clk";
		clocks = <0x42 0x00 0x42 0x04 0x42 0x05 0x42 0x03 0x42 0x01 0x42 0x02 0x42 0x06 0x27 0x2b 0x27 0x33 0x1e 0x6f 0x1e 0x70 0x1e 0x03 0x1e 0x71 0x1e 0x29 0x1e 0x72 0x1e 0x2c 0x43 0x08 0x1f>;
		compatible = "mediatek,mt_soc_pcm_dl1";
		interrupts = <0x00 0x99 0x08>;
		linux,phandle = <0x9d>;
		phandle = <0x9d>;
		reg = <0x00 0x11220000 0x00 0x1000>;
	};

	mt_soc_dl2_pcm {
		compatible = "mediatek,mt_soc_pcm_dl2";
	};

	mt_soc_dummy_pcm {
		compatible = "mediatek,mt_soc_pcm_dummy";
	};

	mt_soc_fm_i2s_awb_pcm {
		compatible = "mediatek,mt_soc_pcm_fm_i2s_awb";
	};

	mt_soc_fm_i2s_pcm {
		compatible = "mediatek,mt_soc_pcm_fm_i2s";
	};

	mt_soc_fm_mrgtx_pcm {
		compatible = "mediatek,mt_soc_pcm_fmtx";
	};

	mt_soc_hp_impedance_pcm {
		compatible = "mediatek,mt_soc_pcm_hp_impedance";
	};

	mt_soc_i2s0_awb_pcm {
		compatible = "mediatek,mt_soc_pcm_i2s0_awb";
	};

	mt_soc_i2s0_pcm {
		compatible = "mediatek,mt_soc_pcm_dl1_i2s0";
	};

	mt_soc_i2s0dl1_pcm {
		compatible = "mediatek,mt_soc_pcm_dl1_i2s0dl1";
	};

	mt_soc_mrgrx_awb_pcm {
		compatible = "mediatek,mt_soc_pcm_mrgrx_awb";
	};

	mt_soc_mrgrx_pcm {
		compatible = "mediatek,mt_soc_pcm_mrgrx";
	};

	mt_soc_pcm_dl1_scp_spk {
		compatible = "mediatek,mt_soc_pcm_dl1_scp_spk";
	};

	mt_soc_pcm_voice_scp {
		compatible = "mediatek,mt_soc_pcm_voice_scp";
	};

	mt_soc_pcm_voice_ultra {
		compatible = "mediatek,mt_soc_pcm_voice_ultra";
	};

	mt_soc_pcm_voice_usb {
		compatible = "mediatek,mt_soc_pcm_voice_usb";
	};

	mt_soc_pcm_voice_usb_echoref {
		compatible = "mediatek,mt_soc_pcm_voice_usb_echoref";
	};

	mt_soc_routing_dai_name {
		compatible = "mediatek,mt_soc_dai_routing";
	};

	mt_soc_routing_pcm {
		compatible = "mediatek,mt_soc_pcm_routing";
	};

	mt_soc_tdmrx_pcm {
		compatible = "mediatek,mt_soc_tdm_capture";
	};

	mt_soc_ul1_pcm {
		compatible = "mediatek,mt_soc_pcm_capture";
	};

	mt_soc_ul2_pcm {
		compatible = "mediatek,mt_soc_pcm_capture2";
	};

	mt_soc_uldlloopback_pcm {
		compatible = "mediatek,mt_soc_pcm_uldlloopback";
	};

	mt_soc_voice_md1 {
		compatible = "mediatek,mt_soc_pcm_voice_md1";
	};

	mt_soc_voice_md1_bt {
		compatible = "mediatek,mt_soc_pcm_voice_md1_bt";
	};

	mt_soc_voice_md2 {
		compatible = "mediatek,mt_soc_pcm_voice_md2";
	};

	mt_soc_voice_md2_bt {
		compatible = "mediatek,mt_soc_pcm_voice_md2_bt";
	};

	mt_soc_voip_bt_in {
		compatible = "mediatek,mt_soc_pcm_bt_dai";
	};

	mt_soc_voip_bt_out {
		compatible = "mediatek,mt_soc_pcm_dl1_bt";
	};

	mtk-btcvsd-snd@18050000 {
		compatible = "mediatek,mtk-btcvsd-snd";
		interrupts = <0x00 0x10a 0x08>;
		linux,phandle = <0x41>;
		mediatek,infracfg = <0x27>;
		mediatek,offset = <0xf00 0x800 0x140 0x144 0x148>;
		phandle = <0x41>;
		reg = <0x00 0x18050000 0x00 0x1000 0x00 0x18080000 0x00 0x10000>;
	};

	mtkfb@0 {
		compatible = "mediatek,mtkfb";
		linux,phandle = <0xa1>;
		phandle = <0xa1>;
	};

	nfc {
		compatible = "mediatek,nfc-gpio-v2";
		gpio-irq = <0x0a>;
		gpio-irq-std = <0x20 0x0a 0x00>;
		gpio-rst = <0xac>;
		gpio-rst-std = <0x20 0xac 0x00>;
		linux,phandle = <0x9f>;
		phandle = <0x9f>;
	};

	nfi@11018000 {
		compatible = "mediatek,nfi";
		reg = <0x00 0x11018000 0x00 0x1000>;
	};

	nfiecc@11019000 {
		compatible = "mediatek,nfiecc";
		reg = <0x00 0x11019000 0x00 0x1000>;
	};

	odm {
		compatible = "simple-bus";
		linux,phandle = <0xae>;
		phandle = <0xae>;
	};

	oppo_secure_common {
		compatible = "oppo,secure_common";
		linux,phandle = <0x82>;
		phandle = <0x82>;
	};

	otg_iddig {
		compatible = "mediatek,usb_iddig_bi_eint";
		linux,phandle = <0x7b>;
		phandle = <0x7b>;
		pinctrl-0 = <0x21>;
		pinctrl-1 = <0x22>;
		pinctrl-names = "iddig_init\0iddig_low";
		usbid-gpio = <0x20 0x29 0x00>;
	};

	pericfg@10003000 {
		#clock-cells = <0x01>;
		compatible = "mediatek,pericfg\0syscon";
		linux,phandle = <0x57>;
		phandle = <0x57>;
		reg = <0x00 0x10003000 0x00 0x1000>;
	};

	pinctrl@1000b000 {
		#gpio-cells = <0x02>;
		#interrupt-cells = <0x04>;
		compatible = "mediatek,mt6765-pinctrl";
		gpio-controller;
		interrupt-controller;
		interrupts = <0x00 0xab 0x04>;
		linux,phandle = <0x20>;
		mediatek,pctl-regmap = <0x12 0x13 0x14 0x15 0x16 0x17 0x18 0x19>;
		phandle = <0x20>;
		pins-are-numbered;
		reg = <0x00 0x1000b000 0x00 0x1000>;

		flashlight_pins_default {
			linux,phandle = <0x4d>;
			phandle = <0x4d>;

			pins_cmd_dat0 {
				output-low;
				pinmux = <0x600>;
				slew-rate = <0x01>;
			};

			pins_cmd_dat1 {
				output-low;
				pinmux = <0x9d00>;
				slew-rate = <0x01>;
			};
		};

		flashlight_pins_srobe_off {
			linux,phandle = <0x4f>;
			phandle = <0x4f>;

			pins_cmd_dat {
				output-low;
				pinmux = <0x9d00>;
				slew-rate = <0x01>;
			};
		};

		flashlight_pins_srobe_on {
			linux,phandle = <0x4e>;
			phandle = <0x4e>;

			pins_cmd_dat {
				output-high;
				pinmux = <0x9d00>;
				slew-rate = <0x01>;
			};
		};

		flashlight_pins_torch_off {
			linux,phandle = <0x51>;
			phandle = <0x51>;

			pins_cmd_dat {
				output-low;
				pinmux = <0x600>;
				slew-rate = <0x01>;
			};
		};

		flashlight_pins_torch_on {
			linux,phandle = <0x50>;
			phandle = <0x50>;

			pins_cmd_dat {
				output-high;
				pinmux = <0x600>;
				slew-rate = <0x01>;
			};
		};

		flashlight_pins_torch_pwm {
			linux,phandle = <0x52>;
			phandle = <0x52>;

			pins_cmd_dat {
				output-low;
				pinmux = <0x603>;
				slew-rate = <0x01>;
			};
		};

		iddig_high {
			linux,phandle = <0x21>;
			phandle = <0x21>;

			pins_cmd_dat {
				bias-pull-up;
				pinmux = <0x2900>;
				slew-rate = <0x00>;
			};
		};

		iddig_low {
			linux,phandle = <0x22>;
			phandle = <0x22>;

			pins_cmd_dat {
				output-low;
				pinmux = <0x2900>;
				slew-rate = <0x01>;
			};
		};

		msdc0@default {
			linux,phandle = <0x35>;
			phandle = <0x35>;

			pins_clk {
				drive-strength = [03];
			};

			pins_cmd {
				drive-strength = [03];
			};

			pins_dat {
				drive-strength = [03];
			};

			pins_ds {
				drive-strength = [03];
			};

			pins_rst {
				drive-strength = [03];
			};
		};

		msdc0@hs200 {
			linux,phandle = <0x37>;
			phandle = <0x37>;

			pins_clk {
				drive-strength = [04];
			};

			pins_cmd {
				drive-strength = [03];
			};

			pins_dat {
				drive-strength = [04];
			};

			pins_ds {
				drive-strength = [04];
			};

			pins_rst {
				drive-strength = [03];
			};
		};

		msdc0@hs400 {
			linux,phandle = <0x36>;
			phandle = <0x36>;

			pins_clk {
				drive-strength = [04];
			};

			pins_cmd {
				drive-strength = [03];
			};

			pins_dat {
				drive-strength = [04];
			};

			pins_ds {
				drive-strength = [04];
			};

			pins_rst {
				drive-strength = [03];
			};
		};

		msdc0@register_default {
			cmd_edge = [00];
			linux,phandle = <0x38>;
			phandle = <0x38>;
			rdata_edge = [00];
			wdata_edge = [00];
		};

		msdc1@ddr50 {
			linux,phandle = <0x3d>;
			phandle = <0x3d>;

			pins_clk {
				drive-strength = [03];
			};

			pins_cmd {
				drive-strength = [03];
			};

			pins_dat {
				drive-strength = [03];
			};
		};

		msdc1@default {
			linux,phandle = <0x3a>;
			phandle = <0x3a>;

			pins_clk {
				drive-strength = [03];
			};

			pins_cmd {
				drive-strength = [03];
			};

			pins_dat {
				drive-strength = [03];
			};
		};

		msdc1@register_default {
			cmd_edge = [00];
			linux,phandle = <0x3e>;
			phandle = <0x3e>;
			rdata_edge = [00];
			wdata_edge = [00];
		};

		msdc1@sdr104 {
			linux,phandle = <0x3b>;
			phandle = <0x3b>;

			pins_clk {
				drive-strength = [03];
			};

			pins_cmd {
				drive-strength = [03];
			};

			pins_dat {
				drive-strength = [03];
			};
		};

		msdc1@sdr50 {
			linux,phandle = <0x3c>;
			phandle = <0x3c>;

			pins_clk {
				drive-strength = [03];
			};

			pins_cmd {
				drive-strength = [03];
			};

			pins_dat {
				drive-strength = [03];
			};
		};

		msdc3@default {
			linux,phandle = <0x5a>;
			phandle = <0x5a>;

			pins_clk {
				drive-strength = [04];
			};

			pins_cmd {
				drive-strength = [04];
			};

			pins_dat {
				drive-strength = [04];
			};
		};

		msdc3@register_default {
			cmd_edge = [01];
			linux,phandle = <0x5b>;
			phandle = <0x5b>;
			rdata_edge = [01];
			wdata_edge = [01];
		};
	};

	plat_sram_flag@0011db00 {
		compatible = "mediatek,plat_sram_flag";
		reg = <0x00 0x10e5f0 0x00 0x10>;
	};

	pmic_clock_buffer_ctrl {
		compatible = "mediatek,pmic_clock_buffer";
		linux,phandle = <0xb0>;
		mediatek,clkbuf-config = <0x02 0x01 0x01 0x02 0x00 0x00 0x00>;
		mediatek,clkbuf-driving-current = <0x01 0x01 0x01 0x01 0x01 0x01 0x01>;
		mediatek,clkbuf-quantity = <0x07>;
		phandle = <0xb0>;
	};

	pmu {
		compatible = "arm,armv8-pmuv3";
		interrupt-parent = <0x11>;
		interrupts = <0x01 0x07 0x08>;
	};

	psci {
		compatible = "arm,psci-1.0";
		method = "smc";
	};

	pseudo_m4u {
		compatible = "mediatek,mt-pseudo_m4u";
		iommus = <0x53 0x02>;
	};

	pseudo_m4u-larb0 {
		compatible = "mediatek,mt-pseudo_m4u-port";
		iommus = <0x53 0x00 0x53 0x01 0x53 0x02 0x53 0x03 0x53 0x04 0x53 0x05 0x53 0x06 0x53 0x07>;
		mediatek,larbid = <0x00>;
	};

	pseudo_m4u-larb1 {
		compatible = "mediatek,mt-pseudo_m4u-port";
		iommus = <0x53 0x20 0x53 0x21>;
		mediatek,larbid = <0x01>;
	};

	pseudo_m4u-larb2 {
		compatible = "mediatek,mt-pseudo_m4u-port";
		iommus = <0x53 0x40 0x53 0x41>;
		mediatek,larbid = <0x02>;
	};

	pseudo_m4u-larb3 {
		compatible = "mediatek,mt-pseudo_m4u-port";
		iommus = <0x53 0x60 0x53 0x61>;
		mediatek,larbid = <0x03>;
	};

	pwm@11006000 {
		clock-names = "PWM1-main\0PWM2-main\0PWM3-main\0PWM4-main\0PWM5-main\0PWM6-main\0PWM-HCLK-main\0PWM-main";
		clocks = <0x27 0x10 0x27 0x11 0x27 0x12 0x27 0x13 0x27 0x14 0x27 0x30 0x27 0x0f 0x27 0x15>;
		compatible = "mediatek,pwm";
		interrupts = <0x00 0x4d 0x08>;
		linux,phandle = <0x91>;
		phandle = <0x91>;
		reg = <0x00 0x11006000 0x00 0x10000>;
	};

	pwrap@1000d000 {
		compatible = "mediatek,pwrap";
		interrupts = <0x00 0xb3 0x04>;
		reg = <0x00 0x1000d000 0x00 0x1000>;
	};

	radio_md_cfg {
		compatible = "mediatek,radio_md_cfg";
		linux,phandle = <0xba>;
		phandle = <0xba>;
	};

	reserved-memory {
		#address-cells = <0x02>;
		#size-cells = <0x02>;
		linux,phandle = <0x55>;
		phandle = <0x55>;
		ranges;

		consys-reserve-memory {
			alignment = <0x00 0x1000000>;
			alloc-ranges = <0x00 0x40000000 0x00 0x80000000>;
			compatible = "mediatek,consys-reserve-memory";
			no-map;
			size = <0x00 0x400000>;
		};

		reserve-memory-scp_share {
			alignment = <0x00 0x1000000>;
			alloc-ranges = <0x00 0x40000000 0x00 0x50000000>;
			compatible = "mediatek,reserve-memory-scp_share";
			no-map;
			size = <0x00 0x300000>;
		};

		reserve-memory-sspm_share {
			alignment = <0x00 0x10000>;
			alloc-ranges = <0x00 0x40000000 0x00 0x60000000>;
			compatible = "mediatek,reserve-memory-sspm_share";
			no-map;
			size = <0x00 0x110000>;
			status = "okay";
		};

		wifi-reserve-memory {
			alignment = <0x00 0x1000000>;
			alloc-ranges = <0x00 0x40000000 0x00 0x80000000>;
			compatible = "mediatek,wifi-reserve-memory";
			no-map;
			size = <0x00 0x300000>;
		};
	};

	rt-pd-manager {
		compatible = "mediatek,rt-pd-manager";
	};

	rt9465_slave_chr {
		compatible = "richtek,rt9465";
		linux,phandle = <0xaa>;
		phandle = <0xaa>;
		status = "disabled";
	};

	scp@10500000 {
		compatible = "mediatek,scp";
		core_1 = "enable";
		interrupts = <0x00 0xc0 0x04>;
		reg = <0x00 0x10500000 0x00 0x40000 0x00 0x105c0000 0x00 0x3000 0x00 0x105c4000 0x00 0x1000 0x00 0x105d4000 0x00 0x6000>;
		scp_sramSize = <0x40000>;
		status = "okay";
	};

	scp_dvfs {
		clock-names = "clk_mux\0clk_pll_0\0clk_pll_1\0clk_pll_2\0clk_pll_3\0clk_pll_4\0clk_pll_5\0clk_pll_6";
		clocks = <0x1e 0x63 0x1f 0x1e 0x0e 0x1e 0x1a 0x1e 0x02 0x1e 0x17 0x1e 0x06 0x1e 0x19>;
		compatible = "mediatek,scp_dvfs";
	};

	scpsys@10001000 {
		#clock-cells = <0x01>;
		compatible = "mediatek,scpsys\0syscon";
		linux,phandle = <0x28>;
		phandle = <0x28>;
		reg = <0x00 0x10001000 0x00 0x1000 0x00 0x10006000 0x00 0x1000 0x00 0x14002000 0x00 0x1000 0x00 0x1020e000 0x00 0x1000 0x00 0x18004000 0x00 0x1000 0x00 0x18002000 0x00 0x1000>;
	};

	security_ao@1001a000 {
		compatible = "mediatek,security_ao";
		reg = <0x00 0x1001a000 0x00 0x1000>;
	};

	seninf1@1a040000 {
		compatible = "mediatek,seninf1";
		reg = <0x00 0x1a040000 0x00 0x1000>;
	};

	seninf2@1a041000 {
		compatible = "mediatek,seninf2";
		reg = <0x00 0x1a041000 0x00 0x1000>;
	};

	seninf3@1a042000 {
		compatible = "mediatek,seninf3";
		reg = <0x00 0x1a042000 0x00 0x1000>;
	};

	seninf4@1a043000 {
		compatible = "mediatek,seninf4";
		reg = <0x00 0x1a043000 0x00 0x1000>;
	};

	serial@11020000 {
		clock-names = "baud\0bus";
		clocks = <0x1f 0x27 0x16>;
		compatible = "mediatek,mt6758-uart\0mediatek,mt6577-uart";
		dma-names = "tx\0rx";
		dmas = <0x34 0x00 0x34 0x01>;
		interrupts = <0x00 0x5b 0x08>;
		linux,phandle = <0x87>;
		phandle = <0x87>;
		reg = <0x00 0x11002000 0x00 0x1000>;
	};

	serial@11030000 {
		clock-names = "baud\0bus";
		clocks = <0x1f 0x27 0x17>;
		compatible = "mediatek,mt6758-uart\0mediatek,mt6577-uart";
		interrupts = <0x00 0x5c 0x08>;
		linux,phandle = <0x88>;
		phandle = <0x88>;
		reg = <0x00 0x11003000 0x00 0x1000>;
	};

	sleep@10006000 {
		compatible = "mediatek,sleep";
		interrupts = <0x00 0xb5 0x08>;
		reg = <0x00 0x10006000 0x00 0x1000>;
		wakeup-source = <0x1a 0x00 0x04 0x1b 0x01 0x20 0x1c 0x03 0x2000000>;
	};

	sleep_reg_md@1000f000 {
		compatible = "mediatek,sleep_reg_md";
		reg = <0x00 0x1000f000 0x00 0x1000>;
	};

	smart_pa {
		linux,phandle = <0xb4>;
		phandle = <0xb4>;
	};

	smi_common@14002000 {
		clock-names = "mtcmos-mm\0smi-common-gals-comm0\0smi-common-gals-comm1\0smi-common\0mmdvfs_clk_mm_sel_ck\0mmdvfs_clk_mmpll_ck\0mmdvfs_clk_univpll1_d2_ck\0mmdvfs_clk_mmpll_d2_ck";
		clocks = <0x28 0x03 0x29 0x15 0x29 0x16 0x29 0x13 0x1e 0x62 0x1e 0x21 0x1e 0x17 0x1e 0x22>;
		compatible = "mediatek,smi_common";
		larbs = <0x23 0x24 0x25 0x26>;
		mmsys_config = <0x29>;
		nr_larbs = <0x04>;
		reg = <0x00 0x14002000 0x00 0x1000>;
	};

	smi_larb0@14003000 {
		cell-index = <0x00>;
		clock-names = "mtcmos-mm\0mm-larb0";
		clocks = <0x28 0x03 0x29 0x14>;
		compatible = "mediatek,smi_larb0\0mediatek,smi_larb";
		linux,phandle = <0x23>;
		phandle = <0x23>;
		reg = <0x00 0x14003000 0x00 0x1000>;
	};

	smi_larb1@17010000 {
		cell-index = <0x01>;
		clock-names = "mtcmos-vcodec\0venc-larb1";
		clocks = <0x28 0x0a 0x46 0x01>;
		compatible = "mediatek,smi_larb1\0mediatek,smi_larb";
		linux,phandle = <0x24>;
		phandle = <0x24>;
		reg = <0x00 0x17010000 0x00 0x1000>;
	};

	smi_larb2@15021000 {
		cell-index = <0x02>;
		clock-names = "mtcmos-isp\0gals-img2mm\0img-larb2";
		clocks = <0x28 0x05 0x29 0x18 0x44 0x00>;
		compatible = "mediatek,smi_larb2\0mediatek,smi_larb";
		linux,phandle = <0x25>;
		phandle = <0x25>;
		reg = <0x00 0x15021000 0x00 0x1000>;
	};

	smi_larb3@1a002000 {
		cell-index = <0x03>;
		clock-names = "mtcmos-cam\0gals-cam2mm\0cam-larb3";
		clocks = <0x28 0x09 0x29 0x19 0x45 0x00>;
		compatible = "mediatek,smi_larb3\0mediatek,smi_larb";
		linux,phandle = <0x26>;
		phandle = <0x26>;
		reg = <0x00 0x1a002000 0x00 0x1000>;
	};

	spi@1100a000 {
		clock-names = "parent-clk\0sel-clk\0spi-clk";
		clocks = <0x1e 0x0b 0x1e 0x6b 0x27 0x1b>;
		compatible = "mediatek,mt6765-spi";
		interrupts = <0x00 0x76 0x08>;
		linux,phandle = <0x92>;
		mediatek,pad-select = <0x00>;
		phandle = <0x92>;
		reg = <0x00 0x1100a000 0x00 0x1000>;
	};

	spi@11010000 {
		clock-names = "parent-clk\0sel-clk\0spi-clk";
		clocks = <0x1e 0x0b 0x1e 0x6b 0x27 0x34>;
		compatible = "mediatek,mt6765-spi";
		interrupts = <0x00 0x7a 0x08>;
		linux,phandle = <0x93>;
		mediatek,pad-select = <0x00>;
		phandle = <0x93>;
		reg = <0x00 0x11010000 0x00 0x1000>;
	};

	spi@11012000 {
		clock-names = "parent-clk\0sel-clk\0spi-clk";
		clocks = <0x1e 0x0b 0x1e 0x6b 0x27 0x37>;
		compatible = "mediatek,mt6765-spi";
		interrupts = <0x00 0x80 0x08>;
		linux,phandle = <0x94>;
		mediatek,pad-select = <0x00>;
		phandle = <0x94>;
		reg = <0x00 0x11012000 0x00 0x1000>;
	};

	spi@11013000 {
		clock-names = "parent-clk\0sel-clk\0spi-clk";
		clocks = <0x1e 0x0b 0x1e 0x6b 0x27 0x38>;
		compatible = "mediatek,mt6765-spi";
		interrupts = <0x00 0x81 0x08>;
		linux,phandle = <0x95>;
		mediatek,pad-select = <0x00>;
		phandle = <0x95>;
		reg = <0x00 0x11013000 0x00 0x1000>;
	};

	spi@11014000 {
		clock-names = "parent-clk\0sel-clk\0spi-clk";
		clocks = <0x1e 0x0b 0x1e 0x6b 0x27 0x41>;
		compatible = "mediatek,mt6765-spi";
		interrupts = <0x00 0x5f 0x08>;
		linux,phandle = <0x96>;
		mediatek,pad-select = <0x00>;
		phandle = <0x96>;
		reg = <0x00 0x11014000 0x00 0x1000>;
	};

	spi@11015000 {
		clock-names = "parent-clk\0sel-clk\0spi-clk";
		clocks = <0x1e 0x0b 0x1e 0x6b 0x27 0x42>;
		compatible = "mediatek,mt6765-spi";
		interrupts = <0x00 0x60 0x08>;
		linux,phandle = <0x97>;
		mediatek,pad-select = <0x00>;
		phandle = <0x97>;
		reg = <0x00 0x11015000 0x00 0x1000>;
	};

	sramrom@10214000 {
		compatible = "mediatek,sramrom";
		reg = <0x00 0x10214000 0x00 0x1000>;
	};

	sspm@10440000 {
		compatible = "mediatek,sspm";
		interrupt-names = "ipc\0mbox0\0mbox1\0mbox2\0mbox3\0mbox4";
		interrupts = <0x00 0xca 0x04 0x00 0xcd 0x04 0x00 0xce 0x04 0x00 0xcf 0x04 0x00 0xd0 0x04 0x00 0xd1 0x04>;
		reg = <0x00 0x10440000 0x00 0x10000 0x00 0x10450000 0x00 0x100 0x00 0x10451000 0x00 0x08 0x00 0x10460000 0x00 0x100 0x00 0x10461000 0x00 0x08 0x00 0x10470000 0x00 0x100 0x00 0x10471000 0x00 0x08 0x00 0x10480000 0x00 0x100 0x00 0x10481000 0x00 0x08 0x00 0x10490000 0x00 0x100 0x00 0x10491000 0x00 0x08>;
		reg-names = "cfgreg\0mbox0_base\0mbox0_ctrl\0mbox1_base\0mbox1_ctrl\0mbox2_base\0mbox2_ctrl\0mbox3_base\0mbox3_ctrl\0mbox4_base\0mbox4_ctrl";
	};

	swtp {
		compatible = "mediatek, swtp-eint";
		linux,phandle = <0x7d>;
		phandle = <0x7d>;
	};

	sys_cirq@10204000 {
		compatible = "mediatek,sys_cirq";
		interrupts = <0x00 0x118 0x08>;
		mediatek,cirq_num = <0xd1>;
		mediatek,spi_start_offset = <0x48>;
		reg = <0x00 0x10204000 0x00 0x1000>;
	};

	sys_timer@10017000 {
		compatible = "mediatek,sys_timer";
		interrupts = <0x00 0xc2 0x04>;
		reg = <0x00 0x10017000 0x00 0x1000>;
		reg-names = "sys_timer_base";
	};

	syscfg_pctl_0@10005000 {
		compatible = "mediatek,mt6765-pctl-0-syscfg\0syscon";
		linux,phandle = <0x12>;
		phandle = <0x12>;
		reg = <0x00 0x10005000 0x00 0x1000>;
	};

	syscfg_pctl_1@0x10002000 {
		compatible = "mediatek,mt6765-pctl-1-syscfg\0syscon";
		linux,phandle = <0x13>;
		phandle = <0x13>;
		reg = <0x00 0x10002000 0x00 0x1000>;
	};

	syscfg_pctl_2@0x10002200 {
		compatible = "mediatek,mt6765-pctl-2-syscfg\0syscon";
		linux,phandle = <0x14>;
		phandle = <0x14>;
		reg = <0x00 0x10002200 0x00 0x1000>;
	};

	syscfg_pctl_3@0x10002400 {
		compatible = "mediatek,mt6765-pctl-3-syscfg\0syscon";
		linux,phandle = <0x15>;
		phandle = <0x15>;
		reg = <0x00 0x10002400 0x00 0x1000>;
	};

	syscfg_pctl_4@0x10002600 {
		compatible = "mediatek,mt6765-pctl-4-syscfg\0syscon";
		linux,phandle = <0x16>;
		phandle = <0x16>;
		reg = <0x00 0x10002600 0x00 0x1000>;
	};

	syscfg_pctl_5@0x10002800 {
		compatible = "mediatek,mt6765-pctl-5-syscfg\0syscon";
		linux,phandle = <0x17>;
		phandle = <0x17>;
		reg = <0x00 0x10002800 0x00 0x1000>;
	};

	syscfg_pctl_6@0x10002a00 {
		compatible = "mediatek,mt6765-pctl-6-syscfg\0syscon";
		linux,phandle = <0x18>;
		phandle = <0x18>;
		reg = <0x00 0x10002a00 0x00 0x1000>;
	};

	syscfg_pctl_7@0x10002c00 {
		compatible = "mediatek,mt6765-pctl-7-syscfg\0syscon";
		linux,phandle = <0x19>;
		phandle = <0x19>;
		reg = <0x00 0x10002c00 0x00 0x1000>;
	};

	therm_ctrl@1100b000 {
		clock-names = "therm-main";
		clocks = <0x27 0x0a>;
		compatible = "mediatek,therm_ctrl";
		interrupts = <0x00 0x4e 0x08>;
		reg = <0x00 0x1100b000 0x00 0x1000>;
	};

	timer {
		clock-frequency = <0xc65d40>;
		compatible = "arm,armv8-timer";
		interrupt-parent = <0x11>;
		interrupts = <0x01 0x0d 0x08 0x01 0x0e 0x08 0x01 0x0b 0x08 0x01 0x0a 0x08>;
	};

	tkcore {
		compatible = "trustkernel,tkcore";
		interrupts = <0x00 0xf8 0x01>;
	};

	topckgen@10000000 {
		#clock-cells = <0x01>;
		compatible = "mediatek,topckgen\0syscon";
		linux,phandle = <0x1e>;
		phandle = <0x1e>;
		reg = <0x00 0x10000000 0x00 0x1000>;
	};

	topckgen_ao@1001b000 {
		compatible = "mediatek,topckgen_ao";
		reg = <0x00 0x1001b000 0x00 0x1000>;
	};

	topmisc@10011000 {
		compatible = "mediatek,topmisc";
		reg = <0x00 0x10011000 0x00 0x1000>;
	};

	toprgu@10007000 {
		compatible = "mediatek,mt6765-toprgu";
		interrupts = <0x00 0x8b 0x00>;
		reg = <0x00 0x10007000 0x00 0x1000>;
	};

	touch {
		compatible = "mediatek,touch";
		linux,phandle = <0x7e>;
		phandle = <0x7e>;
	};

	trng@1020f000 {
		compatible = "mediatek,trng";
		interrupts = <0x00 0xa1 0x08>;
		reg = <0x00 0x1020f000 0x00 0x1000>;
	};

	type_c_port0 {
		linux,phandle = <0xbd>;
		mt-tcpc,name = "type_c_port0";
		mt-tcpc,role_def = <0x04>;
		mt-tcpc,rp_level = <0x00>;
		mt-tcpc,vconn_supply = <0x01>;
		mt6370pd,intr_gpio = <0x20 0x18 0x00>;
		mt6370pd,intr_gpio_num = <0x18>;
		phandle = <0xbd>;
		tcpc-dual,supported_modes = <0x00>;

		dpm_caps {
			attemp_discover_cable;
			attemp_discover_id;
			attemp_enter_dp_mode;
			dr_check = <0x00>;
			local_dr_data;
			local_dr_power;
			local_no_suspend;
			local_usb_comm;
			local_vconn_supply;
			pr_check = <0x00>;
			pr_check_gp_source;
		};

		pd-data {
			bat,nr = <0x01>;
			pd,charging_policy = <0x21>;
			pd,country_nr = <0x00>;
			pd,id-vdo-data = <0xd10029cf 0x00 0x10000>;
			pd,id-vdo-size = <0x03>;
			pd,mfrs = "RichtekTCPC";
			pd,pid = <0x5081>;
			pd,sink-pdo-data = <0x190c8 0xc0761e3c>;
			pd,sink-pdo-size = <0x02>;
			pd,source-cap-ext = <0x171129cf 0x00 0x102 0x00 0x00 0x2000000>;
			pd,source-pdo-data = <0x19032>;
			pd,source-pdo-size = <0x01>;
			pd,vid = <0x29cf>;

			bat-info0 {
				bat,design_cap = <0xbb8>;
				bat,mfrs = "bat1";
				bat,pid = <0x1711>;
				bat,vid = <0x29cf>;
			};
		};
	};

	usb0@11200000 {
		clock-names = "usb0\0usb0_clk_top_sel\0usb0_clk_univpll3_d4";
		clocks = <0x27 0x08 0x1e 0x76 0x1e 0x20>;
		compatible = "mediatek,mt6765-usb20";
		interrupts = <0x00 0x49 0x08>;
		mode = <0x02>;
		multipoint = <0x01>;
		num_eps = <0x10>;
		reg = <0x00 0x11200000 0x00 0x10000 0x00 0x11cc0000 0x00 0x10000>;
	};

	usb1p_sif@11210000 {
		compatible = "mediatek,usb1p_sif";
		reg = <0x00 0x11210000 0x00 0x10000>;
	};

	usb_sif@11210000 {
		compatible = "mediatek,usb_sif";
		reg = <0x00 0x11210000 0x00 0x10000>;
	};

	utos {
		compatible = "microtrust,utos";
		interrupts = <0x00 0xf9 0x01 0x00 0xfa 0x01>;
	};

	utos_tester {
		compatible = "microtrust,tester-v1";
	};

	vdec@17040000 {
		compatible = "mediatek,vdec";
		interrupts = <0x00 0xe9 0x08>;
		reg = <0x00 0x17040000 0x00 0x10000>;
	};

	venc@17020000 {
		compatible = "mediatek,venc";
		interrupts = <0x00 0xe6 0x08>;
		reg = <0x00 0x17020000 0x00 0x10000>;
	};

	venc_gcon@17000000 {
		#clock-cells = <0x01>;
		clock-names = "MT_SCP_SYS_DIS\0MT_SCP_SYS_VCODEC\0MT_CG_MM_SMI_COMM0\0MT_CG_MM_SMI_COMM1\0MT_CG_MM_SMI_COMMON\0MT_CG_VDEC\0MT_CG_VENC";
		clocks = <0x28 0x03 0x28 0x0a 0x29 0x15 0x29 0x16 0x29 0x13 0x46 0x03 0x46 0x01>;
		compatible = "mediatek,venc_gcon\0syscon";
		linux,phandle = <0x46>;
		phandle = <0x46>;
		reg = <0x00 0x17000000 0x00 0x10000>;
	};

	venc_jpg@17030000 {
		clock-names = "MT_CG_VENC_JPGENC";
		clocks = <0x46 0x02>;
		compatible = "mediatek,venc_jpg";
		interrupts = <0x00 0xe8 0x08>;
		reg = <0x00 0x17030000 0x00 0x10000>;
	};

	wifi@18000000 {
		compatible = "mediatek,wifi";
		interrupts = <0x00 0x10c 0x08>;
		reg = <0x00 0x18000000 0x00 0x100000>;
	};
};
